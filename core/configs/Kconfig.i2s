## core/configs/Kconfig.i2s
```kconfig
menuconfig TLK_I2S
    bool "I2S"
    select TLK_GPIO
    select TLK_DMA

if TLK_I2S

for i in range 0 ${i2s.count}

menuconfig TLK_I2S{i}
    bool "I2S{i}"

endfor

endif # TLK_I2S
```

## core/configs/Kconfig.pmp
```kconfig
menuconfig TLK_PMP
    bool "PMP"


if TLK_PMP

config TLK_PMP_PM_DEVICE
    bool "Enable PM Support"
    depends on TLK_PM
    default y

endif # TLK_PMP
```

## core/configs/Kconfig.random
```kconfig
menuconfig TLK_RANDOM
    bool "RANDOM"
    select TLK_CRYPTO
    select TLK_CRYPTO_TRNG


if TLK_RANDOM

# Global configs
config TLK_RANDOM_USED_PRNG
    bool

config TLK_RANDOM_USED_TRNG
    bool


choice
    prompt "Mode"
    default TLK_RANDOM_PRNG

config TLK_RANDOM_PRNG
    bool "PRNG"
    select TLK_RANDOM_USED_PRNG

config TLK_RANDOM_PRNG_TRNG
    bool "TRNG + PRNG"
    select TLK_RANDOM_USED_TRNG
    select TLK_RANDOM_USED_PRNG

config TLK_RANDOM_TRNG
    bool "TRNG"
    select TLK_RANDOM_USED_TRNG

config TLK_RANDOM_TRNG_DRBG
    bool "TRNG + DRBG"
    select TLK_RANDOM_USED_TRNG

endchoice # Mode


if TLK_RANDOM_USED_TRNG

menu "Entropy sources"

for i in range 0 ${trng.source_count}

menuconfig TLK_RANDOM_TRNG_SOURCE{i}
    bool "SORCE {i}"
    default y


if TLK_RANDOM_TRNG_SOURCE{i}

for j in range 0 ${trng.ro_count}

config TLK_RANDOM_TRNG_SOURCE{i}_RO{j}
    bool "RO {j}"
    default y

endfor

endif # TLK_RANDOM_SOURCE{i}

endfor

endmenu


choice
    prompt "TRNG clock divider"
    default TLK_RANDOM_TRNG_FSEL_32

config TLK_RANDOM_TRNG_FSEL_4
    bool "4"

config TLK_RANDOM_TRNG_FSEL_8
    bool "8"

config TLK_RANDOM_TRNG_FSEL_16
    bool "16"

config TLK_RANDOM_TRNG_FSEL_32
    bool "32"

endchoice # TRNG clock divider


config TLK_RANDOM_TRNG_FSEL
    int
    default 0 if TLK_RANDOM_TRNG_FSEL_4
    default 1 if TLK_RANDOM_TRNG_FSEL_8
    default 2 if TLK_RANDOM_TRNG_FSEL_16
    default 3 if TLK_RANDOM_TRNG_FSEL_32


config TLK_RANDOM_TRNG_TIMEOUT
    int "TRNG waiting timeout (ms)"
    default 2000


config TLK_RANDOM_PM
    bool "Enable PM Support"
    depends on TLK_PM
    default y

endif # TLK_RANDOM_USED_TRNG

endif # TLK_RANDOM
```

## core/configs/Kconfig.rf
```kconfig
menuconfig TLK_RF
    bool "RF"
    select TLK_DMA
    select TLK_PLIC


if TLK_RF

config TLK_RF_RX_SHORT_MODE
    bool "RX short mode"
    default y

config TLK_RF_PM_DEVICE
    bool "Enable PM support"
    depends on TLK_PM
    default y

endif # TLK_RF
```

## core/configs/Kconfig.spi
```kconfig
menuconfig TLK_SPI
    bool "SPI"
    select TLK_GPIO
    select TLK_PLIC

if TLK_SPI

config TLK_SPI_AUTO_CONFIG
    bool

for i in range 0 ${spi.count}

menuconfig TLK_SPI{i}
    bool "SPI{i}"

if TLK_SPI{i}

config TLK_SPI{i}_AUTO_CONFIG
    bool "Configure automatically"
    select TLK_SPI_AUTO_CONFIG

if TLK_SPI{i}_AUTO_CONFIG

choice
    prompt "Role"

config TLK_SPI{i}_AC_ROLE_MASTER
    depends on ${spi.{i}.supports.master.role}
    bool "Master"

config TLK_SPI{i}_AC_ROLE_SLAVE
    depends on ${spi.{i}.supports.slave.role}
    bool "Slave"

endchoice

choice
    prompt "Mode"

for j in range 0 4

config TLK_SPI{i}_AC_MODE_{j}
    bool "Mode {j}"

endfor

endchoice

config TLK_SPI{i}_AC_MODE
    string

for j in range 0 4

    default "TLK_SPI_MODE{j}" if TLK_SPI{i}_AC_MODE_{j}

endfor

choice
    prompt "IO mode"
    default TLK_SPI{i}_AC_IO_MODE_SINGLE

config TLK_SPI{i}_AC_IO_MODE_SINGLE
    bool "Single"

config TLK_SPI{i}_AC_IO_MODE_DUAL
    bool "Dual"

config TLK_SPI{i}_AC_IO_MODE_QUAD
    bool "Quad"

config TLK_SPI{i}_AC_IO_MODE_3LINE
    bool "3 line"

endchoice

config TLK_SPI{i}_AC_IO_MODE
    string
    default "TLK_SPI_SINGLE_MODE" if TLK_SPI{i}_AC_IO_MODE_SINGLE
    default "TLK_SPI_DUAL_MODE" if TLK_SPI{i}_AC_IO_MODE_DUAL
    default "TLK_SPI_QUAD_MODE" if TLK_SPI{i}_AC_IO_MODE_QUAD
    default "TLK_SPI_3_LINE_MODE" if TLK_SPI{i}_AC_IO_MODE_3LINE

config TLK_SPI{i}_AC_FREQUENCY
    int "Clock frequency"
    default 2000000

endif # TLK_SPI{i}_AUTO_CONFIG

endif # TLK_SPI{i}

endfor

endif # TLK_SPI
```

## core/configs/Kconfig.stimer
```kconfig
menu "STIMER"

config TLK_SYSTEM_TIMER_AUTO_MODE
    bool "Enable system timer auto mode"
    default y

config TLK_SYSTEM_TIMER_IRQ_ENABLE
    bool "Enable system timer interrupt"
    default n
    select TLK_PLIC

if TLK_PM

# Enable PM Support
config TLK_STIMER_PM_DEVICE
    bool "Enable PM Support"
    default y

endif # TLK_PM

# STIMER advanced modes
config TLK_SYSTEM_TIMER_ADVANCED_MODE
    bool "Enable system timer advanced modes"


# STIMER advanced mode 32K tick analog readout
config TLK_SYSTEM_TIMER_ADVANCED_USE_32K_TICK_ANALOG_READOUT
    bool "Enable 32K tick analog readout"
    depends on TLK_SYSTEM_TIMER_ADVANCED_MODE
    default y

endmenu
```

## core/configs/Kconfig.trap
```kconfig
menu "TRAP"

config TLK_TRAP_ECALL_NESTING
    bool "Enable nesting into the ecall exception"

endmenu
```

## core/configs/Kconfig.uart
```kconfig
menuconfig TLK_UART
    bool "UART"
    select TLK_GPIO
    select TLK_PLIC      # For basic UART RX
    select TLK_API_TIME  # For basic UART TX


if TLK_UART

# Global TLK_UART configs
config TLK_UART_USED_BLOCKING
    bool

config TLK_UART_USED_IRQ
    bool

config TLK_UART_USED_DMA
    bool


config TLK_UART_USED_AUTO_CONFIG
    bool

config TLK_UART_USED_PM_DEVICE
    bool

config TLK_UART_USED_FLOW_CONTROL
    bool


for i in range 0 ${uart.count}

# Global TLK_UART{i} configs
config TLK_UART{i}_USED_IRQ
    bool
    select TLK_UART_USED_IRQ

config TLK_UART{i}_USED_DMA
    bool
    select TLK_UART_USED_DMA


menuconfig TLK_UART{i}_ENABLED
    bool "Enable UART{i}"


if TLK_UART{i}_ENABLED

menuconfig TLK_UART{i}_AUTO_CONFIG
    bool "Configure automatically"
    select TLK_UART_USED_AUTO_CONFIG


if TLK_UART{i}_AUTO_CONFIG

config TLK_UART{i}_BAUDRATE
    int "Baudrate"
    default 115200


choice
    prompt "Parity"
    default TLK_UART{i}_PARITY_NONE

config TLK_UART{i}_PARITY_NONE
    bool "None"

config TLK_UART{i}_PARITY_EVEN
    bool "Even"

config TLK_UART{i}_PARITY_ODD
    bool "Odd"

endchoice # Parity


config TLK_UART{i}_PARITY
    string
    default "TLK_UART_PARITY_NONE" if TLK_UART{i}_PARITY_NONE
    default "TLK_UART_PARITY_EVEN" if TLK_UART{i}_PARITY_EVEN
    default "TLK_UART_PARITY_ODD" if TLK_UART{i}_PARITY_ODD


choice
    prompt "Stop bit"
    default TLK_UART{i}_STOP_BIT_ONE

config TLK_UART{i}_STOP_BIT_ONE
    bool "One"

config TLK_UART{i}_STOP_BIT_ONE_DOT_FIVE
    bool "One dot five"

config TLK_UART{i}_STOP_BIT_TWO
    bool "Two"

endchoice # Stop bit


config TLK_UART{i}_STOP_BIT
    string
    default "TLK_UART_STOP_BIT_ONE" if TLK_UART{i}_STOP_BIT_ONE
    default "TLK_UART_STOP_BIT_ONE_DOT_FIVE" if TLK_UART{i}_STOP_BIT_ONE_DOT_FIVE
    default "TLK_UART_STOP_BIT_TWO" if TLK_UART{i}_STOP_BIT_TWO


if TLK_UART{i}_FLOW_CONTROL

# Global TLK_UART{i}_FLOW_CONTROL configs
config TLK_UART{i}_FLOW_CONTROL_USED_RTS
    bool

config TLK_UART{i}_FLOW_CONTROL_USED_CTS
    bool


choice
    prompt "Flow control"
    default TLK_UART{i}_FLOW_CONTROL_NONE

config TLK_UART{i}_FLOW_CONTROL_NONE
    bool "None"

config TLK_UART{i}_FLOW_CONTROL_RTS
    bool "RTS"
    select TLK_UART{i}_FLOW_CONTROL_USED_RTS

config TLK_UART{i}_FLOW_CONTROL_CTS
    bool "CTS"
    select TLK_UART{i}_FLOW_CONTROL_USED_CTS

config TLK_UART{i}_FLOW_CONTROL_RTS_CTS
    bool "RTS_CTS"
    select TLK_UART{i}_FLOW_CONTROL_USED_RTS
    select TLK_UART{i}_FLOW_CONTROL_USED_CTS

endchoice # Flow control


config TLK_UART{i}_FLOW_CONTROL_TYPE
    string
    default "TLK_UART_FLOW_NONE" if TLK_UART{i}_FLOW_CONTROL_NONE
    default "TLK_UART_FLOW_RTS" if TLK_UART{i}_FLOW_CONTROL_RTS
    default "TLK_UART_FLOW_CTS" if TLK_UART{i}_FLOW_CONTROL_CTS
    default "TLK_UART_FLOW_RTS_CTS" if TLK_UART{i}_FLOW_CONTROL_RTS_CTS


choice
    prompt "Flow polarity"
    default TLK_UART{i}_FLOW_POLARITY_LOW

config TLK_UART{i}_FLOW_POLARITY_LOW
    bool "Low"

config TLK_UART{i}_FLOW_POLARITY_HIGH
    bool "High"

endchoice # Flow polarity


config TLK_UART{i}_FLOW_POLARITY
    string
    default "TLK_UART_ACTIVE_LOW" if TLK_UART{i}_FLOW_POLARITY_LOW
    default "TLK_UART_ACTIVE_HIGH" if TLK_UART{i}_FLOW_POLARITY_HIGH

endif # TLK_UART{i}_FLOW_CONTROL

endif # UART{i}_AUTO_CONFIG


choice
    prompt "TX mode"
    default TLK_UART{i}_TX_BLOCKING

config TLK_UART{i}_TX_BLOCKING
    bool "Blocking"
    select TLK_UART_USED_BLOCKING

config TLK_UART{i}_TX_IRQ
    bool "Interrupt"
    select TLK_UART{i}_USED_IRQ
    depends on TLK_PLIC

config TLK_UART{i}_TX_DMA
    bool "DMA"
    select TLK_UART{i}_USED_DMA
    select TLK_UART{i}_USED_IRQ
    depends on TLK_DMA
    depends on TLK_PLIC

endchoice # TX mode


config TLK_UART{i}_TX_MODE
    string
    default "TLK_UART_XFER_BLOCKING" if TLK_UART{i}_TX_BLOCKING
    default "TLK_UART_XFER_IRQ" if TLK_UART{i}_TX_IRQ
    default "TLK_UART_XFER_DMA" if TLK_UART{i}_TX_DMA


choice
    prompt "RX mode"
    default TLK_UART{i}_RX_IRQ

config TLK_UART{i}_RX_IRQ
    bool "Interrupt"
    select TLK_UART{i}_USED_IRQ

config TLK_UART{i}_RX_DMA
    bool "DMA"
    select TLK_UART{i}_USED_DMA
    select TLK_UART{i}_USED_IRQ
    depends on TLK_DMA
    depends on TLK_PLIC

endchoice # RX mode


config TLK_UART{i}_RX_MODE
    string
    default "TLK_UART_XFER_BLOCKING" if TLK_UART{i}_RX_BLOCKING
    default "TLK_UART_XFER_IRQ" if TLK_UART{i}_RX_IRQ
    default "TLK_UART_XFER_DMA" if TLK_UART{i}_RX_DMA


if TLK_UART{i}_RX_DMA

choice
    prompt "RX DMA type"

config TLK_UART{i}_RX_DMA_FIXED
    bool "Word only"

config TLK_UART{i}_RX_DMA_WITH_TAIL
    bool "Word with manual tail read"
    depends on TLK_DMA_IRQ_HANDLER

endchoice # RX DMA type


config TLK_UART{i}_RX_DMA_MODE
    string
    default "TLK_UART_RX_DMA_FIXED" if TLK_UART{i}_RX_DMA_FIXED
    default "TLK_UART_RX_DMA_WITH_TAIL" if TLK_UART{i}_RX_DMA_WITH_TAIL

endif # TLK_UART{i}_RX_DMA


config TLK_UART{i}_FLOW_CONTROL
    bool "Use flow control"
    select TLK_UART_USED_FLOW_CONTROL


config TLK_RTS_TRIG_LEVEL
   int "RTS trig level"
   default 5
   range 1 8
   depends on TLK_UART{i}_FLOW_CONTROL


if TLK_PM

config TLK_UART{i}_PM_DEVICE
    bool "Enable PM Support"
    default y
    select TLK_UART_USED_PM_DEVICE

config TLK_UART{i}_PREVENT_SLEEP
    bool "Prevent sleep if busy"

endif # TLK_PM

endif # TLK_UART{i}_ENABLED

endfor

endif # TLK_UART
```

## core/configs/Kconfig.wdt
```kconfig
menuconfig TLK_WDT
    bool "WDT"


if TLK_WDT

config TLK_WDT_STARTUP_ENABLE
    bool "Enable WDT at startup"

config TLK_WDT_STARTUP_TIMEOUT
    int "WDT startup timeout (ms)"
    depends on TLK_WDT_STARTUP_ENABLE
    default 5000

endif # TLK_WDT
```

## kconfig/TL321X/Kconfig.dma
```kconfig
menuconfig TLK_DMA
    bool "DMA"


if TLK_DMA

# DMA IRQ support
config TLK_DMA_IRQ_HANDLER
    bool "Enable IRQ Support"
    depends on TLK_PLIC


# PM device configs
if TLK_PM

config TLK_DMA_PM_DEVICE
    default y
    bool "Enable PM Support"

config TLK_DMA_PREVENT_SLEEP
    bool "Prevent sleep if DMA channels busy"
    
endif # TLK_PM

endif # TLK_DMA
```

## kconfig/TL321X/Kconfig.i2c
```kconfig
menuconfig TLK_I2C
    bool "I2C"
    select TLK_GPIO

if TLK_I2C

config TLK_I2C_AUTO_CONFIG
    bool

config TLK_I2C_DMA
    bool
    select TLK_DMA
    select TLK_PLIC

config TLK_I2C_PM_DEVICE
    bool


menuconfig TLK_I2C0
    bool "I2C0"

if TLK_I2C0

menuconfig TLK_I2C0_AUTO_CONFIG
    bool "Configure automatically"
    select TLK_I2C_AUTO_CONFIG

if TLK_I2C0_AUTO_CONFIG

choice
    prompt "Mode"

config TLK_I2C0_AC_MODE_MASTER
    bool "Master"
    depends on y
    select TLK_I2C0_MASTER

config TLK_I2C0_AC_MODE_SLAVE
    bool "Slave"
    depends on y
    select TLK_I2C0_SLAVE

endchoice

config TLK_I2C0_AC_STRETCH
    bool "Stretch"
    default y

if TLK_I2C0_AC_MODE_MASTER

config TLK_I2C0_AC_CLOCK_SPEED
    int "Clock speed"
    default 400000

endif # TLK_I2C0_AC_MODE_MASTER

if TLK_I2C0_AC_MODE_SLAVE

config TLK_I2C0_AC_ADDRESS
    hex "Address"
    default 0x5A

endif # TLK_I2C0_AC_MODE_SLAVE

endif # TLK_I2C0_AUTO_CONFIG

config TLK_I2C0_DMA
    bool
    select TLK_I2C_DMA

menuconfig TLK_I2C0_MASTER
    bool "Master"
    depends on y

config TLK_I2C0_MASTER_DMA
    bool "Use DMA"
    depends on TLK_I2C0_MASTER
    depends on y
    select TLK_I2C0_DMA

menuconfig TLK_I2C0_SLAVE
    bool "Slave"
    depends on y
    select TLK_PLIC

config TLK_I2C0_SLAVE_DMA
    bool "Use DMA"
    depends on TLK_I2C0_SLAVE
    depends on n
    select TLK_I2C0_DMA

if TLK_PM

config TLK_I2C0_PM_DEVICE
    bool "Enable PM Support"
    default y
    select TLK_I2C_PM_DEVICE

endif # TLK_PM

endif # TLK_I2C0

menuconfig TLK_I2C1
    bool "I2C1"

if TLK_I2C1

menuconfig TLK_I2C1_AUTO_CONFIG
    bool "Configure automatically"
    select TLK_I2C_AUTO_CONFIG

if TLK_I2C1_AUTO_CONFIG

choice
    prompt "Mode"

config TLK_I2C1_AC_MODE_MASTER
    bool "Master"
    depends on y
    select TLK_I2C1_MASTER

config TLK_I2C1_AC_MODE_SLAVE
    bool "Slave"
    depends on n
    select TLK_I2C1_SLAVE

endchoice

config TLK_I2C1_AC_STRETCH
    bool "Stretch"
    default y

if TLK_I2C1_AC_MODE_MASTER

config TLK_I2C1_AC_CLOCK_SPEED
    int "Clock speed"
    default 400000

endif # TLK_I2C1_AC_MODE_MASTER

if TLK_I2C1_AC_MODE_SLAVE

config TLK_I2C1_AC_ADDRESS
    hex "Address"
    default 0x5A

endif # TLK_I2C1_AC_MODE_SLAVE

endif # TLK_I2C1_AUTO_CONFIG

config TLK_I2C1_DMA
    bool
    select TLK_I2C_DMA

menuconfig TLK_I2C1_MASTER
    bool "Master"
    depends on y

config TLK_I2C1_MASTER_DMA
    bool "Use DMA"
    depends on TLK_I2C1_MASTER
    depends on n
    select TLK_I2C1_DMA

menuconfig TLK_I2C1_SLAVE
    bool "Slave"
    depends on n
    select TLK_PLIC

config TLK_I2C1_SLAVE_DMA
    bool "Use DMA"
    depends on TLK_I2C1_SLAVE
    depends on n
    select TLK_I2C1_DMA

if TLK_PM

config TLK_I2C1_PM_DEVICE
    bool "Enable PM Support"
    default y
    select TLK_I2C_PM_DEVICE

endif # TLK_PM

endif # TLK_I2C1

endif # TLK_I2C
```

## kconfig/TL321X/TL3218X_EVK/core/configs/Kconfig.i2s
```kconfig
menuconfig TLK_I2S
    bool "I2S"
    select TLK_GPIO
    select TLK_DMA

if TLK_I2S


menuconfig TLK_I2S0
    bool "I2S0"

endif # TLK_I2S
```

## kconfig/TL321X/TL3218X_EVK/core/configs/Kconfig.plicsw
```kconfig
menuconfig TLK_PLIC_SW
    bool "SW PLIC"


if TLK_PLIC_SW

config TLK_PLIC_SW_NEST_SELECTED
    bool
    default n


config TLK_PLIC_SW_NEST_PLIC_SW
    bool "Nest machine software interrupt (MSIE)"
    select TLK_PLIC_SW_NEST_SELECTED


config TLK_PLIC_SW_NEST_MTIMER
    bool "Nest machine timer interrupt (MTIE)"
    select TLK_PLIC_SW_NEST_SELECTED
    depends on TLK_MTIMER_IRQ_ENABLE


config TLK_PLIC_SW_NEST_PLIC
    bool "Nest external interrupts (MEIE)"
    select TLK_PLIC_SW_NEST_SELECTED
    depends on TLK_PLIC

endif # TLK_PLIC_SW
```
