## kconfig/TL321X/TL3218X_EVK/core/configs/Kconfig.random
```kconfig
menuconfig TLK_RANDOM
    bool "RANDOM"
    select TLK_CRYPTO
    select TLK_CRYPTO_TRNG


if TLK_RANDOM

# Global configs
config TLK_RANDOM_USED_PRNG
    bool

config TLK_RANDOM_USED_TRNG
    bool


choice
    prompt "Mode"
    default TLK_RANDOM_PRNG

config TLK_RANDOM_PRNG
    bool "PRNG"
    select TLK_RANDOM_USED_PRNG

config TLK_RANDOM_PRNG_TRNG
    bool "TRNG + PRNG"
    select TLK_RANDOM_USED_TRNG
    select TLK_RANDOM_USED_PRNG

config TLK_RANDOM_TRNG
    bool "TRNG"
    select TLK_RANDOM_USED_TRNG

config TLK_RANDOM_TRNG_DRBG
    bool "TRNG + DRBG"
    select TLK_RANDOM_USED_TRNG

endchoice # Mode


if TLK_RANDOM_USED_TRNG

menu "Entropy sources"


menuconfig TLK_RANDOM_TRNG_SOURCE0
    bool "SORCE 0"
    default y


if TLK_RANDOM_TRNG_SOURCE0


config TLK_RANDOM_TRNG_SOURCE0_RO0
    bool "RO 0"
    default y

config TLK_RANDOM_TRNG_SOURCE0_RO1
    bool "RO 1"
    default y

config TLK_RANDOM_TRNG_SOURCE0_RO2
    bool "RO 2"
    default y

config TLK_RANDOM_TRNG_SOURCE0_RO3
    bool "RO 3"
    default y

config TLK_RANDOM_TRNG_SOURCE0_RO4
    bool "RO 4"
    default y

config TLK_RANDOM_TRNG_SOURCE0_RO5
    bool "RO 5"
    default y

config TLK_RANDOM_TRNG_SOURCE0_RO6
    bool "RO 6"
    default y

config TLK_RANDOM_TRNG_SOURCE0_RO7
    bool "RO 7"
    default y

config TLK_RANDOM_TRNG_SOURCE0_RO8
    bool "RO 8"
    default y

config TLK_RANDOM_TRNG_SOURCE0_RO9
    bool "RO 9"
    default y

config TLK_RANDOM_TRNG_SOURCE0_RO10
    bool "RO 10"
    default y

config TLK_RANDOM_TRNG_SOURCE0_RO11
    bool "RO 11"
    default y

config TLK_RANDOM_TRNG_SOURCE0_RO12
    bool "RO 12"
    default y

config TLK_RANDOM_TRNG_SOURCE0_RO13
    bool "RO 13"
    default y

config TLK_RANDOM_TRNG_SOURCE0_RO14
    bool "RO 14"
    default y

config TLK_RANDOM_TRNG_SOURCE0_RO15
    bool "RO 15"
    default y

endif # TLK_RANDOM_SOURCE0

menuconfig TLK_RANDOM_TRNG_SOURCE1
    bool "SORCE 1"
    default y


if TLK_RANDOM_TRNG_SOURCE1


config TLK_RANDOM_TRNG_SOURCE1_RO0
    bool "RO 0"
    default y

config TLK_RANDOM_TRNG_SOURCE1_RO1
    bool "RO 1"
    default y

config TLK_RANDOM_TRNG_SOURCE1_RO2
    bool "RO 2"
    default y

config TLK_RANDOM_TRNG_SOURCE1_RO3
    bool "RO 3"
    default y

config TLK_RANDOM_TRNG_SOURCE1_RO4
    bool "RO 4"
    default y

config TLK_RANDOM_TRNG_SOURCE1_RO5
    bool "RO 5"
    default y

config TLK_RANDOM_TRNG_SOURCE1_RO6
    bool "RO 6"
    default y

config TLK_RANDOM_TRNG_SOURCE1_RO7
    bool "RO 7"
    default y

config TLK_RANDOM_TRNG_SOURCE1_RO8
    bool "RO 8"
    default y

config TLK_RANDOM_TRNG_SOURCE1_RO9
    bool "RO 9"
    default y

config TLK_RANDOM_TRNG_SOURCE1_RO10
    bool "RO 10"
    default y

config TLK_RANDOM_TRNG_SOURCE1_RO11
    bool "RO 11"
    default y

config TLK_RANDOM_TRNG_SOURCE1_RO12
    bool "RO 12"
    default y

config TLK_RANDOM_TRNG_SOURCE1_RO13
    bool "RO 13"
    default y

config TLK_RANDOM_TRNG_SOURCE1_RO14
    bool "RO 14"
    default y

config TLK_RANDOM_TRNG_SOURCE1_RO15
    bool "RO 15"
    default y

endif # TLK_RANDOM_SOURCE1

menuconfig TLK_RANDOM_TRNG_SOURCE2
    bool "SORCE 2"
    default y


if TLK_RANDOM_TRNG_SOURCE2


config TLK_RANDOM_TRNG_SOURCE2_RO0
    bool "RO 0"
    default y

config TLK_RANDOM_TRNG_SOURCE2_RO1
    bool "RO 1"
    default y

config TLK_RANDOM_TRNG_SOURCE2_RO2
    bool "RO 2"
    default y

config TLK_RANDOM_TRNG_SOURCE2_RO3
    bool "RO 3"
    default y

config TLK_RANDOM_TRNG_SOURCE2_RO4
    bool "RO 4"
    default y

config TLK_RANDOM_TRNG_SOURCE2_RO5
    bool "RO 5"
    default y

config TLK_RANDOM_TRNG_SOURCE2_RO6
    bool "RO 6"
    default y

config TLK_RANDOM_TRNG_SOURCE2_RO7
    bool "RO 7"
    default y

config TLK_RANDOM_TRNG_SOURCE2_RO8
    bool "RO 8"
    default y

config TLK_RANDOM_TRNG_SOURCE2_RO9
    bool "RO 9"
    default y

config TLK_RANDOM_TRNG_SOURCE2_RO10
    bool "RO 10"
    default y

config TLK_RANDOM_TRNG_SOURCE2_RO11
    bool "RO 11"
    default y

config TLK_RANDOM_TRNG_SOURCE2_RO12
    bool "RO 12"
    default y

config TLK_RANDOM_TRNG_SOURCE2_RO13
    bool "RO 13"
    default y

config TLK_RANDOM_TRNG_SOURCE2_RO14
    bool "RO 14"
    default y

config TLK_RANDOM_TRNG_SOURCE2_RO15
    bool "RO 15"
    default y

endif # TLK_RANDOM_SOURCE2

menuconfig TLK_RANDOM_TRNG_SOURCE3
    bool "SORCE 3"
    default y


if TLK_RANDOM_TRNG_SOURCE3


config TLK_RANDOM_TRNG_SOURCE3_RO0
    bool "RO 0"
    default y

config TLK_RANDOM_TRNG_SOURCE3_RO1
    bool "RO 1"
    default y

config TLK_RANDOM_TRNG_SOURCE3_RO2
    bool "RO 2"
    default y

config TLK_RANDOM_TRNG_SOURCE3_RO3
    bool "RO 3"
    default y

config TLK_RANDOM_TRNG_SOURCE3_RO4
    bool "RO 4"
    default y

config TLK_RANDOM_TRNG_SOURCE3_RO5
    bool "RO 5"
    default y

config TLK_RANDOM_TRNG_SOURCE3_RO6
    bool "RO 6"
    default y

config TLK_RANDOM_TRNG_SOURCE3_RO7
    bool "RO 7"
    default y

config TLK_RANDOM_TRNG_SOURCE3_RO8
    bool "RO 8"
    default y

config TLK_RANDOM_TRNG_SOURCE3_RO9
    bool "RO 9"
    default y

config TLK_RANDOM_TRNG_SOURCE3_RO10
    bool "RO 10"
    default y

config TLK_RANDOM_TRNG_SOURCE3_RO11
    bool "RO 11"
    default y

config TLK_RANDOM_TRNG_SOURCE3_RO12
    bool "RO 12"
    default y

config TLK_RANDOM_TRNG_SOURCE3_RO13
    bool "RO 13"
    default y

config TLK_RANDOM_TRNG_SOURCE3_RO14
    bool "RO 14"
    default y

config TLK_RANDOM_TRNG_SOURCE3_RO15
    bool "RO 15"
    default y

endif # TLK_RANDOM_SOURCE3

endmenu


choice
    prompt "TRNG clock divider"
    default TLK_RANDOM_TRNG_FSEL_32

config TLK_RANDOM_TRNG_FSEL_4
    bool "4"

config TLK_RANDOM_TRNG_FSEL_8
    bool "8"

config TLK_RANDOM_TRNG_FSEL_16
    bool "16"

config TLK_RANDOM_TRNG_FSEL_32
    bool "32"

endchoice # TRNG clock divider


config TLK_RANDOM_TRNG_FSEL
    int
    default 0 if TLK_RANDOM_TRNG_FSEL_4
    default 1 if TLK_RANDOM_TRNG_FSEL_8
    default 2 if TLK_RANDOM_TRNG_FSEL_16
    default 3 if TLK_RANDOM_TRNG_FSEL_32


config TLK_RANDOM_TRNG_TIMEOUT
    int "TRNG waiting timeout (ms)"
    default 2000


config TLK_RANDOM_PM
    bool "Enable PM Support"
    depends on TLK_PM
    default y

endif # TLK_RANDOM_USED_TRNG

endif # TLK_RANDOM
```

## kconfig/TL321X/TL3218X_EVK/samples/pmp_demo/Kconfig
```kconfig
config TLK_PMP_DEMO
    def_bool y
    select TLK_PMP


menu "PMP Sample configuration"

# Mode selection
choice
    prompt "PMP mode"
    default TLK_PMP_DEMO_TOR

config TLK_PMP_DEMO_OFF
    bool "OFF"

config TLK_PMP_DEMO_TOR
    bool "TOR"

config TLK_PMP_DEMO_NAPOT
    bool "NAPOT"

endchoice # PMP mode


# Action selection
choice
    prompt "Action mode"
    default TLK_PMP_DEMO_READ

config TLK_PMP_DEMO_READ
    bool "READ"

config TLK_PMP_DEMO_WRITE
    bool "WRITE"

endchoice # Action mode


# Demo with sleep
config TLK_PMP_DEMO_SLEEP
    bool "PMP demo with sleep"
    depends on !TLK_PMP_DEMO_OFF
    select TLK_API_SLEEP
    imply TLK_PMP_PM_DEVICE

endmenu
```

## kconfig/TL321X/TL3218X_EVK/samples/stimer_demo/Kconfig
```kconfig
config TLK_STIMER_DEMO
    def_bool y
    select TLK_STIMER
    select TLK_API_TIME
    select TLK_API_SLEEP


menu "Stimer Sample configuration"

config TLK_STIMER_INTERRUPT
    bool "Stimer demo with interrupt"
    select TLK_SYSTEM_TIMER_IRQ_ENABLE
    def_bool y

endmenu

config TLK_BLE_CONTROLLER
    default n
```

## kconfig/TL721X/Kconfig.crypto
```kconfig
menuconfig TLK_CRYPTO
    bool "Crypto functionality"


if TLK_CRYPTO

config TLK_CRYPTO_DMA_SUPPORT
    bool "Support DMA functionality for cryptography"
    select TLK_DMA
    depends on y

config TLK_CRYPTO_TRNG
    bool "Support random functionality"
    depends on y

config TLK_CRYPTO_HASH
    bool "Support hash functionality"
    depends on y

config TLK_CRYPTO_CHACHA20
    bool "Support chacha20 functionality"
    depends on y

config TLK_CRYPTO_PKE
    bool "Support public key engine functionality"
    select TLK_CRYPTO_TRNG if y
    select TLK_CRYPTO_HASH if y
    depends on y

config TLK_CRYPTO_SKE
    bool "Support symmetric key engine functionality"
    depends on y

endif # TLK_CRYPTO
```

## kconfig/TL721X/Kconfig.gpio
```kconfig
menuconfig TLK_GPIO
    bool "GPIO"


if TLK_GPIO

menu "Select enabled ports"


config TLK_GPIO_PORT_0_ENABLED
    bool

config TLK_GPIO_PORT_A_ENABLED
    select TLK_GPIO_PORT_0_ENABLED
    bool "Enable GPIO port A"
    default y

config TLK_GPIO_PORT_1_ENABLED
    bool

config TLK_GPIO_PORT_B_ENABLED
    select TLK_GPIO_PORT_1_ENABLED
    bool "Enable GPIO port B"
    default y

config TLK_GPIO_PORT_2_ENABLED
    bool

config TLK_GPIO_PORT_C_ENABLED
    select TLK_GPIO_PORT_2_ENABLED
    bool "Enable GPIO port C"
    default y

config TLK_GPIO_PORT_3_ENABLED
    bool

config TLK_GPIO_PORT_D_ENABLED
    select TLK_GPIO_PORT_3_ENABLED
    bool "Enable GPIO port D"
    default y

config TLK_GPIO_PORT_4_ENABLED
    bool

config TLK_GPIO_PORT_E_ENABLED
    select TLK_GPIO_PORT_4_ENABLED
    bool "Enable GPIO port E"
    default y

config TLK_GPIO_PORT_5_ENABLED
    bool

config TLK_GPIO_PORT_F_ENABLED
    select TLK_GPIO_PORT_5_ENABLED
    bool "Enable GPIO port F"
    default y

endmenu


if TLK_PM

# Enable PM Support
config TLK_GPIO_PM_DEVICE
    bool "Enable PM Support"
    default y


# Prevent sleep if some pin out is enabled
config TLK_GPIO_PREVENT_SLEEP
    bool "Prevent sleep if some output pin is enabled"

endif # TLK_PM

endif # TLK_GPIO
```

## kconfig/TL721X/Kconfig.mtimer
```kconfig
menuconfig TLK_MTIMER
    bool "MTIMER"


if TLK_MTIMER

config TLK_MTIMER_ENABLE_IRQ
    bool "Enable interrupts"

config TLK_MTIMER_ENABLE_NESTING
    bool "Enable nesting into the machine timer interrupts"
    depends on TLK_MTIMER_ENABLE_IRQ

endif # TLK_MTIMER
```

## kconfig/TL721X/Kconfig.spi
```kconfig
menuconfig TLK_SPI
    bool "SPI"
    select TLK_GPIO
    select TLK_PLIC

if TLK_SPI

config TLK_SPI_AUTO_CONFIG
    bool


menuconfig TLK_SPI0
    bool "SPI0"

if TLK_SPI0

config TLK_SPI0_AUTO_CONFIG
    bool "Configure automatically"
    select TLK_SPI_AUTO_CONFIG

if TLK_SPI0_AUTO_CONFIG

choice
    prompt "Role"

config TLK_SPI0_AC_ROLE_MASTER
    depends on y
    bool "Master"

config TLK_SPI0_AC_ROLE_SLAVE
    depends on y
    bool "Slave"

endchoice

choice
    prompt "Mode"


config TLK_SPI0_AC_MODE_0
    bool "Mode 0"

config TLK_SPI0_AC_MODE_1
    bool "Mode 1"

config TLK_SPI0_AC_MODE_2
    bool "Mode 2"

config TLK_SPI0_AC_MODE_3
    bool "Mode 3"

endchoice

config TLK_SPI0_AC_MODE
    string


    default "TLK_SPI_MODE0" if TLK_SPI0_AC_MODE_0

    default "TLK_SPI_MODE1" if TLK_SPI0_AC_MODE_1

    default "TLK_SPI_MODE2" if TLK_SPI0_AC_MODE_2

    default "TLK_SPI_MODE3" if TLK_SPI0_AC_MODE_3

choice
    prompt "IO mode"
    default TLK_SPI0_AC_IO_MODE_SINGLE

config TLK_SPI0_AC_IO_MODE_SINGLE
    bool "Single"

config TLK_SPI0_AC_IO_MODE_DUAL
    bool "Dual"

config TLK_SPI0_AC_IO_MODE_QUAD
    bool "Quad"

config TLK_SPI0_AC_IO_MODE_3LINE
    bool "3 line"

endchoice

config TLK_SPI0_AC_IO_MODE
    string
    default "TLK_SPI_SINGLE_MODE" if TLK_SPI0_AC_IO_MODE_SINGLE
    default "TLK_SPI_DUAL_MODE" if TLK_SPI0_AC_IO_MODE_DUAL
    default "TLK_SPI_QUAD_MODE" if TLK_SPI0_AC_IO_MODE_QUAD
    default "TLK_SPI_3_LINE_MODE" if TLK_SPI0_AC_IO_MODE_3LINE

config TLK_SPI0_AC_FREQUENCY
    int "Clock frequency"
    default 2000000

endif # TLK_SPI0_AUTO_CONFIG

endif # TLK_SPI0

menuconfig TLK_SPI1
    bool "SPI1"

if TLK_SPI1

config TLK_SPI1_AUTO_CONFIG
    bool "Configure automatically"
    select TLK_SPI_AUTO_CONFIG

if TLK_SPI1_AUTO_CONFIG

choice
    prompt "Role"

config TLK_SPI1_AC_ROLE_MASTER
    depends on y
    bool "Master"

config TLK_SPI1_AC_ROLE_SLAVE
    depends on y
    bool "Slave"

endchoice

choice
    prompt "Mode"


config TLK_SPI1_AC_MODE_0
    bool "Mode 0"

config TLK_SPI1_AC_MODE_1
    bool "Mode 1"

config TLK_SPI1_AC_MODE_2
    bool "Mode 2"

config TLK_SPI1_AC_MODE_3
    bool "Mode 3"

endchoice

config TLK_SPI1_AC_MODE
    string


    default "TLK_SPI_MODE0" if TLK_SPI1_AC_MODE_0

    default "TLK_SPI_MODE1" if TLK_SPI1_AC_MODE_1

    default "TLK_SPI_MODE2" if TLK_SPI1_AC_MODE_2

    default "TLK_SPI_MODE3" if TLK_SPI1_AC_MODE_3

choice
    prompt "IO mode"
    default TLK_SPI1_AC_IO_MODE_SINGLE

config TLK_SPI1_AC_IO_MODE_SINGLE
    bool "Single"

config TLK_SPI1_AC_IO_MODE_DUAL
    bool "Dual"

config TLK_SPI1_AC_IO_MODE_QUAD
    bool "Quad"

config TLK_SPI1_AC_IO_MODE_3LINE
    bool "3 line"

endchoice

config TLK_SPI1_AC_IO_MODE
    string
    default "TLK_SPI_SINGLE_MODE" if TLK_SPI1_AC_IO_MODE_SINGLE
    default "TLK_SPI_DUAL_MODE" if TLK_SPI1_AC_IO_MODE_DUAL
    default "TLK_SPI_QUAD_MODE" if TLK_SPI1_AC_IO_MODE_QUAD
    default "TLK_SPI_3_LINE_MODE" if TLK_SPI1_AC_IO_MODE_3LINE

config TLK_SPI1_AC_FREQUENCY
    int "Clock frequency"
    default 2000000

endif # TLK_SPI1_AUTO_CONFIG

endif # TLK_SPI1

endif # TLK_SPI
```
