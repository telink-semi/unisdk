## samples/tinyusb_demos/usb_device/cdc_demo/Kconfig
```kconfig
config TLK_USB_CDC_DEMO
    select TLK_USB
    def_bool y
config TLK_BLE_CONTROLLER
    default n
```

## samples/uart_demo/Kconfig
```kconfig
menu "UART Sample configuration"

config TLK_UART_DEMO_BUFFER_SIZE
    int "Buffer size"
    default 15

config TLK_UART_DEMO_SLEEP
    bool "UART demo with sleep"
    select TLK_API_SLEEP
    imply TLK_UART0_PM_DEVICE


config TLK_UART_DEMO_PREVENT
    bool "UART demo with prevent"
    select TLK_PM
    select TLK_PM_SUSPEND
    select TLK_UART0_PREVENT_SLEEP

endmenu
```

## samples/uart_demo/Kconfig.uart_demo
```kconfig
config TLK_UART_DEMO
    def_bool y
    select TLK_UART


menu "UART Sample configuration"

# UART Selection
choice
    prompt "UART number"

for i in range 0 ${uart.count}
config TLK_UART_DEMO_UART{i}
    bool "UART{i}"
    select TLK_UART{i}_ENABLED
endfor

endchoice # UART number


# Selected UART 
config TLK_UART_DEMO_UART
    string
for i in range 0 ${uart.count}
    default TLK_UART{i} if TLK_UART_DEMO_UART{i}
endfor


# Selected UART autoconfig check
config TLK_UART_DEMO_AUTO_CONFIG
    bool
for i in range 0 ${uart.count}
    default y if (TLK_UART_DEMO_UART{i} && TLK_UART{i}_AUTO_CONFIG)
endfor


# Buffer size
config TLK_UART_DEMO_BUFFER_SIZE
    int "Buffer size"
    default 15


# Demo configs
config TLK_UART_DEMO_SLEEP
    bool "UART demo with sleep"
    select TLK_API_SLEEP
for i in range 0 ${uart.count}
    imply TLK_UART{i}_PM_DEVICE if TLK_UART_DEMO_UART{i}
endfor
    
config TLK_UART_DEMO_PREVENT
    bool "UART demo with prevent"
    select TLK_PM
    select TLK_PM_SUSPEND
for i in range 0 ${uart.count}
    select TLK_UART{i}_PREVENT_SLEEP if TLK_UART_DEMO_UART{i}
endfor

endmenu
```

## samples/umode_demo/Kconfig
```kconfig
menu "UMODE Sample configuration"

config TLK_UMODE_DEMO_ENABLE_UART
    bool "Enable UART for user task"

config TLK_UMODE_DEMO_ENABLE_SLEEP
    bool "Enable sleep req in user task"

config TLK_UMODE_DEMO_ENABLE_MMODE
    bool "Enable M-mode after user task"


endmenu
```

## samples/umode_demo/ci/max.defconfig
```kconfig
CONFIG_TLK_UMODE_DEMO_ENABLE_UART=y
CONFIG_TLK_UMODE_DEMO_ENABLE_SLEEP=y
CONFIG_TLK_UMODE_DEMO_ENABLE_MMODE=y
```

## samples/wdt_demo/Kconfig
```kconfig
menu "WDT Sample configuration"

config TLK_WDT_DEMO_GPIO_INDICATION
    bool "WDT GPIO indication"
    select TLK_GPIO

config TLK_WDT_DEMO_PM
    bool "WDT with PM"
    select TLK_API_SLEEP
    select TLK_PM

config TLK_WDT_DEMO_STARTUP
    bool "Start WDT from startup code"
    select TLK_WDT_STARTUP

endmenu
```

## samples/wdt_demo/ci/max.defconfig
```kconfig
CONFIG_TLK_WDT_DEMO_GPIO_INDICATION=y
CONFIG_TLK_WDT_DEMO_PM=y
CONFIG_TLK_WDT_DEMO_STARTUP=y
```

## scripts/lib_builder/configs/library.defconfig
```kconfig
CONFIG_TLK_PM=y
CONFIG_TLK_PM_SUSPEND=y
CONFIG_TLK_PM_DEEP_SLEEP=y
CONFIG_TLK_PM_RAM_RETENTION_ENABLE=y
CONFIG_TLK_PM_ALLOW_FALLBACK_TO_SUSPEND=y
CONFIG_TLK_RF=y
CONFIG_TLK_CRYPTO=y
CONFIG_TLK_SYSTEM_TIMER_ADVANCED=y
```

## soc/Kconfig
```kconfig
config TLK_HAS_BGA56_CASE
    bool

config TLK_HAS_BGA94_CASE
    bool

config TLK_HAS_LGA42_CASE
    bool

config TLK_HAS_QFN28_CASE
    bool

config TLK_HAS_QFN32_CASE
    bool

config TLK_HAS_QFN38_CASE
    bool

config TLK_HAS_QFN40_CASE
    bool

config TLK_HAS_QFN48_CASE
    bool

config TLK_HAS_QFN52_CASE
    bool

config TLK_HAS_QFN56_CASE
    bool

config TLK_HAS_QFN64_CASE
    bool

config TLK_HAS_QFN68_CASE
    bool

config TLK_HAS_QFN88_CASE
    bool

config TLK_CASE
    string
    default "BGA56" if TLK_HAS_BGA56_CASE
    default "BGA94" if TLK_HAS_BGA94_CASE
    default "LGA42" if TLK_HAS_LGA42_CASE
    default "QFN28" if TLK_HAS_QFN28_CASE
    default "QFN32" if TLK_HAS_QFN32_CASE
    default "QFN38" if TLK_HAS_QFN38_CASE
    default "QFN40" if TLK_HAS_QFN40_CASE
    default "QFN48" if TLK_HAS_QFN48_CASE
    default "QFN52" if TLK_HAS_QFN52_CASE
    default "QFN56" if TLK_HAS_QFN56_CASE
    default "QFN64" if TLK_HAS_QFN64_CASE
    default "QFN68" if TLK_HAS_QFN68_CASE
    default "QFN88" if TLK_HAS_QFN88_CASE


choice
    prompt "SoC Series"

config TLK_SOC_SERIES_TL321X
    bool "TL321X"
    select TLK_CORE_TL321X

config TLK_SOC_SERIES_TL721X
    bool "TL721X"
    select TLK_CORE_TL721X

config TLK_SOC_SERIES_TLSR922X
    bool "TLSR922X"
    select TLK_CORE_B92

config TLK_SOC_SERIES_TLSR952X
    bool "TLSR952X"
    select TLK_CORE_B92

endchoice # SoC Series

config TLK_SOC_SERIES
    string
    default "TL321X" if TLK_SOC_SERIES_TL321X
    default "TL721X" if TLK_SOC_SERIES_TL721X
    default "TLSR922X" if TLK_SOC_SERIES_TLSR922X
    default "TLSR952X" if TLK_SOC_SERIES_TLSR952X


if TLK_SOC_SERIES_TL321X
    rsource "TL321X/Kconfig"
endif # TLK_SOC_SERIES_TL321X

if TLK_SOC_SERIES_TL721X
    rsource "TL721X/Kconfig"
endif # TLK_SOC_SERIES_TL721X

if TLK_SOC_SERIES_TLSR922X
    rsource "TLSR922X/Kconfig"
endif # TLK_SOC_SERIES_TLSR922X

if TLK_SOC_SERIES_TLSR952X
    rsource "TLSR952X/Kconfig"
endif # TLK_SOC_SERIES_TLSR952X
```

## soc/TL321X/Kconfig
```kconfig
choice
    prompt "SoC"

config TLK_SOC_TL3218X
    bool "TL3218X"
    select TLK_HAS_QFN64_CASE

config TLK_SOC_TL3219D
    bool "TL3219D"
    select TLK_HAS_QFN38_CASE

config TLK_SOC_TL3218B
    bool "TL3218B"
    select TLK_HAS_QFN52_CASE

config TLK_SOC_TL3218K
    bool "TL3218K"
    select TLK_HAS_LGA42_CASE

config TLK_SOC_TL3218E
    bool "TL3218E"
    select TLK_HAS_QFN32_CASE

config TLK_SOC_TL3218F
    bool "TL3218F"
    select TLK_HAS_QFN28_CASE

config TLK_SOC_TL3215C
    bool "TL3215C"
    select TLK_HAS_QFN48_CASE

endchoice # SoC


config TLK_SOC
    string
    default "TL3218X" if TLK_SOC_TL3218X
    default "TL3219D" if TLK_SOC_TL3219D
    default "TL3218B" if TLK_SOC_TL3218B
    default "TL3218K" if TLK_SOC_TL3218K
    default "TL3218E" if TLK_SOC_TL3218E
    default "TL3218F" if TLK_SOC_TL3218F
    default "TL3215C" if TLK_SOC_TL3215C
```

## soc/TL721X/Kconfig
```kconfig
choice
    prompt "SoC"

config TLK_SOC_TL7218X
    bool "TL7218X"
    select TLK_HAS_QFN88_CASE

config TLK_SOC_TL7218A
    bool "TL7218A"
    select TLK_HAS_QFN68_CASE

config TLK_SOC_TL7218D
    bool "TL7218D"
    select TLK_HAS_QFN38_CASE

config TLK_SOC_TL7218H
    bool "TL7218H"
    select TLK_HAS_BGA94_CASE

config TLK_SOC_TL7218J
    bool "TL7218J"
    select TLK_HAS_BGA56_CASE

config TLK_SOC_TL7215A
    bool "TL7215A"
    select TLK_HAS_QFN68_CASE

config TLK_SOC_TL7215D
    bool "TL7215D"
    select TLK_HAS_QFN38_CASE

endchoice # SoC


config TLK_SOC
    string
    default "TL7218X" if TLK_SOC_TL7218X
    default "TL7218A" if TLK_SOC_TL7218A
    default "TL7218D" if TLK_SOC_TL7218D
    default "TL7218H" if TLK_SOC_TL7218H
    default "TL7218J" if TLK_SOC_TL7218J
    default "TL7215A" if TLK_SOC_TL7215A
    default "TL7215D" if TLK_SOC_TL7215D
```

## soc/TLSR922X/Kconfig
```kconfig
choice
    prompt "SoC"

config TLK_SOC_TLSR9228A
    bool "TLSR9228A"
    #TODO: clarify the packaging of this SoC
    select TLK_HAS_QFN88_CASE

config TLK_SOC_TLSR9228H
    bool "TLSR9228H"
    select TLK_HAS_QFN48_CASE

endchoice # SoC


config TLK_SOC
    string
    default "TLSR9228A" if TLK_SOC_TLSR9228A
    default "TLSR9228H" if TLK_SOC_TLSR9228H
```

## soc/TLSR952X/Kconfig
```kconfig
choice
    prompt "SoC"

config TLK_SOC_TLSR9528A
    bool "TLSR9528A"
    select TLK_HAS_QFN88_CASE

config TLK_SOC_TLSR9527B
    bool "TLSR9527B"
    select TLK_HAS_QFN40_CASE

config TLK_SOC_TLSR9527C
    bool "TLSR9527C"
    select TLK_HAS_QFN56_CASE

endchoice # SoC


config TLK_SOC
    string
    default "TLSR9528A" if TLK_SOC_TLSR9528A
    default "TLSR9527B" if TLK_SOC_TLSR9527B
    default "TLSR9527C" if TLK_SOC_TLSR9527C
```

## subsystem/Kconfig
```kconfig
# SPDX-License-Identifier: Apache-2.0

menu "Subsystem Configuration"

    # BLE Controller subsystem
    orsource "ble/controller/Kconfig"

    # MCUBoot subsystem
    orsource "mcuboot/Kconfig"

    # BLE Host v2 subsystem
    orsource "ble/host/prj/unisdk/Kconfig"

endmenu
```

## subsystem/mcuboot/Kconfig
```kconfig
menuconfig TLK_MCUBOOT
    bool "Enable MCUBoot DFU support"
    default n
    help
        Enables MCUBoot partition layout and integration for UniSDK

if TLK_MCUBOOT

choice
    prompt "MCUBoot image type"
    default TLK_MCUBOOT_MODE_BOOTLOADER if TLK_MCUBOOT_BOOTLOADER_APP
    default TLK_MCUBOOT_MODE_APP

config TLK_MCUBOOT_MODE_BOOTLOADER
    bool "Build as MCUBoot bootloader target"
    select TLK_NV_STORAGE
    select TLK_UART
    select TLK_MBEDTLS
    select TLK_MBEDTLS_USE_COMMON_CONFIG
    help
        Links the binary to bootloader partition

config TLK_MCUBOOT_MODE_APP
    bool "Build as Application under MCUboot"
    select TLK_NV_STORAGE
    help
      Links the binary to Slot 0 partition with offset for MCUboot Header.
      Also links bootutil_public.c so the app can call boot_set_confirmed()
      to mark itself confirmed, avoiding a revert on the next reset.

endchoice

config TLK_MCUBOOT_BOOTLOADER_SIZE
    hex "MCUBoot bootloader partition size"
    default 0x00090000
    help
        Size allocated for the bootloader binary (default: 576KB). Sized for mbedtls's
        default config, which measures at ~472KB -- see TLK_MCUBOOT_SLOT_SIZE.
config TLK_MCUBOOT_HEADER_SIZE
    hex "MCUBoot image header size"
    default 0x00000200
    help
        Space reserved at the start of each application slot for the
        MCUboot image header. Must exactly match the --header-size
        passed to imgtool when signing the application image, or the
        signed image's vector table will land at the wrong flash offset.
config TLK_MCUBOOT_SLOT_SIZE
    hex "Slot 0/Slot 1 partition size"
    default 0x000B0000
    help
      Size allocated for each application slot (default: 704KB). Bootloader + 2 slots +
      scratch must fit in the 2MB chip flash alongside TLK_MCUBOOT_BOOTLOADER_SIZE.

      Chips with 32KB of RAM or less use a 128KB slot instead as long as this stays at its
      default value (see MCUBOOT_PORT_SLOT_SIZE in mcuboot_config.h) -- their RAM can't hold
      bootutil's sector-tracking arrays at 704KB. Setting this explicitly overrides that and
      applies on every chip; verify the RAM budget yourself before doing so on a small-RAM chip.
config TLK_MCUBOOT_SCRATCH_SIZE
    hex "Scratch partition size"
    default 0x00004000
    help
        Size allocated for swap operations (default: 16KB)

config TLK_MCUBOOT_SERIAL_RECOVERY
    bool "Enable serial recovery (DFU) console"
    default n
    depends on TLK_MCUBOOT_MODE_BOOTLOADER
    help
        Compiles in boot_serial and hands the selected transport to it
        when the DFU-entry GPIO is held at reset.

if TLK_MCUBOOT_SERIAL_RECOVERY

choice
    prompt "MCUboot serial recovery transport"
    default TLK_MCUBOOT_SERIAL_TRANSPORT_UART

config TLK_MCUBOOT_SERIAL_TRANSPORT_UART
    bool "UART"
    select TLK_UART
    help
        Runs the DFU console over a tlk_uart_module instance.

config TLK_MCUBOOT_SERIAL_TRANSPORT_USB
    bool "USB CDC ACM"
    select TLK_TINY_USB
    select TLK_USB_CLASS_CDC
    help
        Runs the DFU console over a USB CDC ACM virtual COM port.
        Device descriptor fields (VID/PID/strings) are taken from the
        TinyUSB "Device parameters" Kconfig menu.

endchoice

config TLK_MCUBOOT_SERIAL_UART
    int "UART instance used for MCUboot serial recovery"
    default 0
    depends on TLK_MCUBOOT_SERIAL_TRANSPORT_UART
    help
        Selects which tlk_uart_module the MCUboot serial recovery transport uses.
        The corresponding TLK_UARTx must still be enabled and configured through the UART Kconfig menu.

endif # TLK_MCUBOOT_SERIAL_RECOVERY

config TLK_MCUBOOT_PRODUCTION_KEY
    bool "Signing key in keys.c is a real production key"
    default n
    depends on TLK_MCUBOOT_MODE_BOOTLOADER
    help
        Silences the SDK development-key warning once
        you've replaced the public key bytes in subsystem/mcuboot/port/keys.c with your own.

endif # TLK_MCUBOOT
```

## system/Kconfig.mbedtls
```kconfig
menuconfig TLK_MBEDTLS
    bool "Enable mbedtls library"
    imply TLK_CRYPTO
    imply TLK_CRYPTO_DMA_SUPPORT
    imply TLK_CRYPTO_TRNG
    imply TLK_CRYPTO_HASH
    imply TLK_CRYPTO_PKE
    imply TLK_CRYPTO_SKE
```

## system/Kconfig.task_planner
```kconfig
menu "Task Planner"

# Task planner top-level enable
menuconfig TLK_TASK_PLANNER
    bool "Enable task planner"

if TLK_TASK_PLANNER

# Task planner execution mode
choice
    prompt "Task Planner mode"
    default TLK_TASK_PLANNER_MODE_LOOP

config TLK_TASK_PLANNER_MODE_LOOP
    bool "Loop"
    select TLK_API_TIME

config TLK_TASK_PLANNER_MODE_SCHEDULER
    bool "Scheduler"
    select TLK_MTIMER
    select TLK_MTIMER_IRQ_ENABLE

# config TLK_TASK_PLANNER_MODE_RTOS
#     bool "RTOS"

endchoice # Task Planner mode


# Default task enable
config TLK_TASK_PLANNER_DEFAULT_TASK
    bool "Enable default task"
    depends on TLK_TASK_PLANNER_MODE_SCHEDULER

# Default task loop period
config TLK_TASK_PLANNER_DEFAULT_TASK_LOOP_PERIOD_MS
    int "Default task loop period (ms)"
    default 500
    depends on TLK_TASK_PLANNER_DEFAULT_TASK


# Work queue task enable
config TLK_TASK_PLANNER_WORK_QUEUE
    bool "Enable work queue task"
    select TLK_PLIC_SW

# Work queue depth
config TLK_TASK_PLANNER_WORK_QUEUE_SIZE
    int "Work queue task stack size"
    default 16
    depends on TLK_TASK_PLANNER_WORK_QUEUE

endif # TLK_TASK_PLANNER


# Software timers enable
config TLK_SOFTWARE_TIMERS
    bool "Enable software timers"
    select TLK_MTIMER

endmenu
```

## system/storage/Kconfig.nv_storage
```kconfig
menuconfig TLK_NV_STORAGE
    bool "NV storage subsystem"


if TLK_NV_STORAGE

config TLK_SOC_FLASH
    bool "SOC flash NV storage back-end"
    default y

endif # TLK_NV_STORAGE
```
