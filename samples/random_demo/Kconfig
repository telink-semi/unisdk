## samples/random_demo/Kconfig
```kconfig
config TLK_RANDOM_DEMO
    def_bool y
    select TLK_RANDOM
    select TLK_API_TIME


menu "Random Demo Configuration"

config TLK_RANDOM_DEMO_NUMBERS_COUNT
    int "Numbers count"
    default 10
    range 1 100


config TLK_RANDOM_DEMO_MAX_NUMBER
    int "Max number"
    default 10


config TLK_RANDOM_DEMO_SLEEP
    bool "Random demo with sleep"
    select TLK_API_SLEEP
    imply TLK_RANDOM_PM

endmenu
```

## samples/rf_demo/Kconfig
```kconfig
menu "RF Demo Configuration"

config TLK_RF_DEMO
    bool
    select TLK_RF
    select TLK_GPIO
    select TLK_API_PRINT # TODO: change to log
    select TLK_API_TIME
    default y

config TLK_RF_DEMO_PM
    bool "RF Demo with PM"
    select TLK_API_SLEEP
    imply TLK_RF_PM_DEVICE


choice
    prompt "Mode"

config TLK_RF_DEMO_MODE_BLE
    bool "BLE"

config TLK_RF_DEMO_MODE_ZIGBEE
    bool "Zigbee"

config TLK_RF_DEMO_MODE_PRIVATE
    bool "Private"

config TLK_RF_DEMO_MODE_HYBEE
    bool "Hybee"

endchoice # Mode

config TLK_RF_DEMO_MODE
    string
    default "TLK_RF_MODE_BLE" if TLK_RF_DEMO_MODE_BLE
    default "TLK_RF_MODE_ZIGBEE" if TLK_RF_DEMO_MODE_ZIGBEE
    default "TLK_RF_MODE_PRIVATE" if TLK_RF_DEMO_MODE_PRIVATE
    default "TLK_RF_MODE_HYBEE" if TLK_RF_DEMO_MODE_HYBEE


choice
    prompt "Bitrate"

config TLK_RF_DEMO_BITRATE_125K
    bool "125K"
    depends on TLK_RF_DEMO_MODE_BLE

config TLK_RF_DEMO_BITRATE_250K
    bool "250K"
    depends on TLK_RF_DEMO_MODE_PRIVATE || TLK_RF_DEMO_MODE_ZIGBEE

config TLK_RF_DEMO_BITRATE_500K
    bool "500K"
    depends on TLK_RF_DEMO_MODE_BLE || TLK_RF_DEMO_MODE_PRIVATE || TLK_RF_DEMO_MODE_HYBEE

config TLK_RF_DEMO_BITRATE_1M
    bool "1M"
    depends on TLK_RF_DEMO_MODE_BLE || TLK_RF_DEMO_MODE_PRIVATE || TLK_RF_DEMO_MODE_HYBEE

config TLK_RF_DEMO_BITRATE_2M
    bool "2M"
    depends on TLK_RF_DEMO_MODE_BLE || TLK_RF_DEMO_MODE_PRIVATE || TLK_RF_DEMO_MODE_HYBEE

endchoice # Bitrate

config TLK_RF_DEMO_BITRATE
    string
    default "TLK_RF_BITRATE_125K" if TLK_RF_DEMO_BITRATE_125K
    default "TLK_RF_BITRATE_250K" if TLK_RF_DEMO_BITRATE_250K
    default "TLK_RF_BITRATE_500K" if TLK_RF_DEMO_BITRATE_500K
    default "TLK_RF_BITRATE_1M" if TLK_RF_DEMO_BITRATE_1M
    default "TLK_RF_BITRATE_2M" if TLK_RF_DEMO_BITRATE_2M


choice
    prompt "Device role"

config TLK_RF_DEMO_ROLE_TRANSMITTER
    bool "Transmitter"
    help
        Sends the ping signals, listening for pong answers

config TLK_RF_DEMO_ROLE_RECEIVER
    bool "Receiver"
    help
        Listens for ping signals and sends a pong answer

endchoice # Device role


choice
    prompt "Exchange API"

config TLK_RF_DEMO_EXCHANGE_MANUAL
    bool "Manual"

config TLK_RF_DEMO_EXCHANGE_STX_SRX
    bool "STX & SRX"

config TLK_RF_DEMO_EXCHANGE_STR_SRT
    bool "STR & SRT"

config TLK_RF_DEMO_EXCHANGE_BTX_BRX
    bool "BTX & BRX"

config TLK_RF_DEMO_EXCHANGE_PTX_PRX
    bool "PTX & PRX"

endchoice # Exchange API


if TLK_RF_DEMO_EXCHANGE_MANUAL

config TLK_RF_DEMO_POLLING_MODE
    bool "Use polling mode"

config TLK_RF_DEMO_MODE_SWITCHING
    bool "Switch between selected modes"

if TLK_RF_DEMO_MODE_SWITCHING

choice
    prompt "The second mode"

config TLK_RF_DEMO_SECOND_MODE_BLE
    bool "BLE"

config TLK_RF_DEMO_SECOND_MODE_ZIGBEE
    bool "Zigbee"

config TLK_RF_DEMO_SECOND_MODE_PRIVATE
    bool "Private"

config TLK_RF_DEMO_SECOND_MODE_HYBEE
    bool "Hybee"

endchoice # Mode

config TLK_RF_DEMO_SECOND_MODE
    string
    default "TLK_RF_MODE_BLE" if TLK_RF_DEMO_SECOND_MODE_BLE
    default "TLK_RF_MODE_ZIGBEE" if TLK_RF_DEMO_SECOND_MODE_ZIGBEE
    default "TLK_RF_MODE_PRIVATE" if TLK_RF_DEMO_SECOND_MODE_PRIVATE
    default "TLK_RF_MODE_HYBEE" if TLK_RF_DEMO_SECOND_MODE_HYBEE


choice
    prompt "Bitrate of the second mode"

config TLK_RF_DEMO_SECOND_BITRATE_125K
    bool "125K"
    depends on TLK_RF_DEMO_SECOND_MODE_BLE

config TLK_RF_DEMO_SECOND_BITRATE_250K
    bool "250K"
    depends on TLK_RF_DEMO_SECOND_MODE_PRIVATE || TLK_RF_DEMO_SECOND_MODE_ZIGBEE

config TLK_RF_DEMO_SECOND_BITRATE_500K
    bool "500K"
    depends on TLK_RF_DEMO_SECOND_MODE_BLE || TLK_RF_DEMO_SECOND_MODE_PRIVATE || TLK_RF_DEMO_SECOND_MODE_HYBEE

config TLK_RF_DEMO_SECOND_BITRATE_1M
    bool "1M"
    depends on TLK_RF_DEMO_SECOND_MODE_BLE || TLK_RF_DEMO_SECOND_MODE_PRIVATE || TLK_RF_DEMO_SECOND_MODE_HYBEE

config TLK_RF_DEMO_SECOND_BITRATE_2M
    bool "2M"
    depends on TLK_RF_DEMO_SECOND_MODE_BLE || TLK_RF_DEMO_SECOND_MODE_PRIVATE || TLK_RF_DEMO_SECOND_MODE_HYBEE

endchoice # Bitrate

config TLK_RF_DEMO_SECOND_BITRATE
    string
    default "TLK_RF_BITRATE_125K" if TLK_RF_DEMO_SECOND_BITRATE_125K
    default "TLK_RF_BITRATE_250K" if TLK_RF_DEMO_SECOND_BITRATE_250K
    default "TLK_RF_BITRATE_500K" if TLK_RF_DEMO_SECOND_BITRATE_500K
    default "TLK_RF_BITRATE_1M" if TLK_RF_DEMO_SECOND_BITRATE_1M
    default "TLK_RF_BITRATE_2M" if TLK_RF_DEMO_SECOND_BITRATE_2M


endif # TLK_RF_DEMO_MODE_SWITCHING


config TLK_RF_DEMO_CHANNEL_SWITCHING
    bool "Switch between channels"
    depends on TLK_RF_DEMO_MODE_BLE
    depends on !TLK_RF_DEMO_MODE_SWITCHING

endif # TLK_RF_DEMO_EXCHANGE_MANUAL

config TLK_RF_DEMO_SB_FORMAT
    bool "Use SB format"
    depends on TLK_RF_DEMO_MODE_PRIVATE
    depends on TLK_RF_DEMO_EXCHANGE_PTX_PRX # not mandatory, just a sample restriction

config TLK_RF_DEMO_PIPE_SWITCHING
    bool "Switch logical channels (pipes)"
    depends on TLK_RF_DEMO_MODE_PRIVATE
    depends on TLK_RF_DEMO_EXCHANGE_PTX_PRX

endmenu
```

## samples/rf_demo/ci/brx.defconfig
```kconfig
CONFIG_TLK_RF_DEMO_PM=y
CONFIG_TLK_RF_DEMO_ROLE_RECEIVER=y
CONFIG_TLK_RF_DEMO_EXCHANGE_BTX_BRX=y
```

## samples/rf_demo/ci/btx.defconfig
```kconfig
CONFIG_TLK_RF_DEMO_PM=y
CONFIG_TLK_RF_DEMO_ROLE_TRANSMITTER=y
CONFIG_TLK_RF_DEMO_EXCHANGE_BTX_BRX=y
```

## samples/rf_demo/ci/mrx.defconfig
```kconfig
CONFIG_TLK_RF_DEMO_PM=y
CONFIG_TLK_RF_DEMO_ROLE_RECEIVER=y
CONFIG_TLK_RF_DEMO_EXCHANGE_MANUAL=y
CONFIG_TLK_RF_DEMO_POLLING_MODE=y
CONFIG_TLK_RF_DEMO_MODE_SWITCHING=y
```

## samples/rf_demo/ci/mtx.defconfig
```kconfig
CONFIG_TLK_RF_DEMO_PM=y
CONFIG_TLK_RF_DEMO_ROLE_TRANSMITTER=y
CONFIG_TLK_RF_DEMO_EXCHANGE_MANUAL=y
CONFIG_TLK_RF_DEMO_POLLING_MODE=y
CONFIG_TLK_RF_DEMO_MODE_SWITCHING=y
```

## samples/rf_demo/ci/mtx_fs.defconfig
```kconfig
CONFIG_TLK_RF_DEMO_PM=y
CONFIG_TLK_RF_DEMO_ROLE_TRANSMITTER=y
CONFIG_TLK_RF_DEMO_EXCHANGE_MANUAL=y
CONFIG_TLK_RF_DEMO_MODE_BLE=y
CONFIG_TLK_RF_DEMO_CHANNEL_SWITCHING=y
```

## samples/rf_demo/ci/prx.defconfig
```kconfig
CONFIG_TLK_RF_DEMO_PM=y
CONFIG_TLK_RF_DEMO_ROLE_RECEIVER=y
CONFIG_TLK_RF_DEMO_EXCHANGE_PTX_PRX=y
CONFIG_TLK_RF_DEMO_MODE_PRIVATE=y
CONFIG_TLK_RF_DEMO_PIPE_SWITCHING=y
```

## samples/rf_demo/ci/srt.defconfig
```kconfig
CONFIG_TLK_RF_DEMO_PM=y
CONFIG_TLK_RF_DEMO_ROLE_RECEIVER=y
CONFIG_TLK_RF_DEMO_EXCHANGE_STR_SRT=y
```

## samples/rf_demo/ci/srx.defconfig
```kconfig
CONFIG_TLK_RF_DEMO_PM=y
CONFIG_TLK_RF_DEMO_ROLE_RECEIVER=y
CONFIG_TLK_RF_DEMO_EXCHANGE_STX_SRX=y
```

## samples/rf_demo/ci/str.defconfig
```kconfig
CONFIG_TLK_RF_DEMO_PM=y
CONFIG_TLK_RF_DEMO_ROLE_TRANSMITTER=y
CONFIG_TLK_RF_DEMO_EXCHANGE_STR_SRT=y
```

## samples/rf_demo/ci/stx.defconfig
```kconfig
CONFIG_TLK_RF_DEMO_PM=y
CONFIG_TLK_RF_DEMO_ROLE_TRANSMITTER=y
CONFIG_TLK_RF_DEMO_EXCHANGE_STX_SRX=y
```

## samples/spi_demo/Kconfig
```kconfig
menu "SPI Sample configuration"

choice
    prompt "Device role"

config TLK_SPI_DEMO_ROLE_MASTER
    bool "Master"

config TLK_SPI_DEMO_ROLE_SLAVE
    bool "Slave"

endchoice

endmenu
```

## samples/stimer_demo/Kconfig
```kconfig
menu "Stimer Sample configuration"

config TLK_STIMER_INTERRUPT
    bool "Stimer demo with interrupt"
    select TLK_STIMER_IRQ
    def_bool y

endmenu
```

## samples/system_demo/task_planner_demo/Kconfig
```kconfig
config TLK_GPIO
    def_bool y

config TLK_TASK_PLANNER_DEMO
    def_bool y
    select TLK_TASK_PLANNER
```
