## samples/adc_demo/Kconfig
```kconfig
menu "ADC Sample configuration"

config TLK_ADC_DEMO_DMA
    bool "ADC Demo with DMA"
    select TLK_ADC_DMA

config TLK_ADC_DEMO_PM
    bool "ADC Demo with PM"
    select TLK_API_SLEEP
    select TLK_ADC_PM_DEVICE

endmenu
```

## samples/adv_demo/Kconfig
```kconfig
config TLK_ADV_DEMO
    bool
    select TLK_RF
    select TLK_GPIO
    default y
```

## samples/audio_demo/Kconfig
```kconfig
menu "Audio Demo Configuration"

config TLK_AUDIO_DEMO
    bool
    select TLK_AUDIO
    select TLK_NV_STORAGE
    select TLK_DMA_IRQ_HANDLER
    default y

endmenu
```

## samples/dma_demo/Kconfig
```kconfig
config TLK_DMA_DEMO
    def_bool y
    select TLK_DMA
    select TLK_API_PRINT # TODO: change to log
    select TLK_API_TIME


menu "DMA Sample configuration"

config TLK_DMA_DEMO_INTERRUPT
    bool "DMA demo with interrupt"
    select TLK_PLIC
    select TLK_DMA_IRQ_HANDLER
    
config TLK_DMA_DEMO_SLEEP
    bool "DMA demo with sleep"
    select TLK_API_SLEEP
    imply TLK_DMA_PM_DEVICE

config TLK_DMA_DEMO_PREVENT
    bool "DMA demo with prevent"
    select TLK_PM
    select TLK_PM_SUSPEND
    select TLK_DMA_PREVENT_SLEEP

endmenu
```

## samples/dma_demo/ci/max.defconfig
```kconfig
CONFIG_TLK_DMA_DEMO_INTERRUPT=y
CONFIG_TLK_DMA_DEMO_SLEEP=y
CONFIG_TLK_DMA_DEMO_PREVENT=y
```

## samples/gpio_demo/Kconfig
```kconfig
menu "GPIO Sample configuration"

config TLK_GPIO_DEMO_INTERRUPT
    bool "GPIO demo with interrupt"
    select TLK_PLIC

endmenu
```

## samples/i2c_demo/ds1307/Kconfig
```kconfig
config TLK_I2C_DEMO
    def_bool y
    select TLK_I2C
    select TLK_I2C0
    select TLK_I2C0_MASTER
    select TLK_GPIO
    select TLK_PLIC
```

## samples/i2c_demo/ping_pong/Kconfig
```kconfig
config TLK_I2C_DEMO
    def_bool y
    select TLK_I2C
    select TLK_I2C0

menu "I2C Sample configuration"

choice
    prompt "Device role"

config TLK_I2C_DEMO_ROLE_MASTER
    bool "Master"
    select TLK_I2C0_MASTER

config TLK_I2C_DEMO_ROLE_SLAVE
    bool "Slave"
    select TLK_I2C0_SLAVE

endchoice

config TLK_I2C_DEMO_PM
    bool "I2C Demo with PM"
    select TLK_API_SLEEP
    imply TLK_I2C0_PM_DEVICE

endmenu
```

## samples/i2s_demo/Kconfig
```kconfig
menu "I2S Sample Configuration"

choice
    prompt "Device role"

config TLK_I2S_DEMO_ROLE_MASTER
    bool "Master"

config TLK_I2S_DEMO_ROLE_SLAVE
    bool "Slave"

endchoice

endmenu
```

## samples/irq_demo/Kconfig
```kconfig
menu "IRQ Sample configuration"

choice TLK_IRQ_DEMO_IRQ_BASE
    prompt "Interrupt nesting base"
    default TLK_IRQ_DEMO_IRQ_BASE_PLIC_SW

config TLK_IRQ_DEMO_IRQ_BASE_PLIC_SW
    bool "PLIC_SW (MSI)"

config TLK_IRQ_DEMO_IRQ_BASE_MTIMER
    bool "MTIMER (MTI)"

config TLK_IRQ_DEMO_IRQ_BASE_PLIC
    bool "PLIC (MEI)"
endchoice


config TLK_IRQ_DEMO_PLIC_PREEMPT
    bool "PLIC with PREEMPT"
    select TLK_PLIC_NEST_PLIC
    depends on TLK_IRQ_DEMO_IRQ_BASE_PLIC

endmenu
```

## samples/irq_nesting_demo/Kconfig
```kconfig
config TLK_IRQ_NESTING_DEMO
    bool
    default y
    select TLK_PLIC
    select TLK_PLIC_SW
    select TLK_MTIMER
    select TLK_MTIMER_ENABLE_IRQ
    select TLK_GPIO
    select TLK_API_PRINT # TODO: change to log
    select TLK_API_TIME

menu "IRQ Nesting Sample configuration"

choice TLK_SOURCE_HOST
    prompt "The Source into which it will be nested"
    default TLK_NEST_INTO_EXT

config TLK_NEST_INTO_SW
    bool "Nest IRQs into software ISR"
    select TLK_PLIC_SW_ENABLE_NESTING

config TLK_NEST_INTO_EXT
    bool "Nest IRQs into external (peripheral) ISR"
    depends on !TLK_PLIC_VECTOR_MODE
    select TLK_PLIC_ENABLE_NESTING

config TLK_NEST_INTO_MTIMER
    bool "Nest IRQs into mtimer ISR"
    select TLK_MTIMER_ENABLE_NESTING

endchoice

config TLK_NEST_SW
    bool "Nest software IRQ into SOURCE_HOST ISR"
    depends on !TLK_NEST_INTO_SW

config TLK_NEST_EXT
    bool "Nest external (peripheral) IRQ into SOURCE_HOST ISR"
    depends on !TLK_NEST_INTO_EXT

config TLK_NEST_MTIMER
    bool "Nest mtimer IRQ into SOURCE_HOST ISR"
    depends on !TLK_NEST_INTO_MTIMER

endmenu
```

## samples/mcuboot_bootloader_demo/Kconfig
```kconfig
config TLK_MCUBOOT_BOOTLOADER_APP
    def_bool y

config TLK_MEMORY_STACK_SIZE
    default 96
```

## samples/nv_storage_demo/Kconfig
```kconfig
config TLK_NV_STORAGE_DEMO
    def_bool y
    select TLK_NV_STORAGE
    select TLK_API_PRINT # TODO: change to log
```

## samples/pm_demo/Kconfig
```kconfig
menu "PM Sample Configuration"

config TLK_PM_DEMO_ENABLE_GPIO_INPUT
    bool "PM demo with GPIO input"
    select TLK_GPIO

config TLK_PM_DEMO_ENABLE_LED
    bool "PM demo with LED"
    select TLK_GPIO

config TLK_PM_DEMO_DISABLE_LED_BEFORE_SLEEP
    bool "Disable LED before sleep"
    depends on TLK_PM_DEMO_ENABLE_LED

endmenu
```

## samples/pm_demo/ci/max.defconfig
```kconfig
CONFIG_TLK_PM_DEMO_ENABLE_GPIO_INPUT=y
CONFIG_TLK_PM_DEMO_ENABLE_LED=y
CONFIG_TLK_PM_DEMO_DISABLE_LED_BEFORE_SLEEP=y
```

## samples/pmp_demo/ci/max.defconfig
```kconfig
CONFIG_TLK_PMP_DEMO_NAPOT=y
CONFIG_TLK_PMP_DEMO_WRITE=y
CONFIG_TLK_PMP_DEMO_SLEEP=y
```
