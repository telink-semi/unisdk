## kconfig/TLSR952X/Kconfig.tinyusb
```kconfig
menu "TinyUSB configurations"

# --------------------------------------------------------------------------
# Device classes
# --------------------------------------------------------------------------

choice
    prompt "USB Device Class"
    default TLK_USB_CLASS_CDC

config TLK_USB_CLASS_CDC
    bool "Enable CDC ACM"

endchoice # USB Device Class


# --------------------------------------------------------------------------
# Device settings
# --------------------------------------------------------------------------
menu "Device parameters"

config TLK_USB_VENDOR_ID
    hex "Vendor Identifier for USB device descriptor"
    default 0x248A

config TLK_USB_PRODUCT_ID
    hex "Product Identifier for USB device descriptor"
    default 0x0100

config TLK_USB_DEVICE_VERSION
    hex "Firmware version for the USB host"
    default 0x0100 # Decode to 01.00

config TLK_USB_DEVICE_MANUFACTURER
    string "Device manufacturer name"
    default "Telink Semiconductors"

config TLK_USB_DEVICE_PRODUCT_NAME
    string "Device product name"
    default "Telink Semiconductors CDC Device" if TLK_USB_CLASS_CDC

config TLK_USB_DEVICE_SERIAL_NUMBER
    string "Device serial number in string"
    default "123456789012"

config TLK_USB_DEVICE_INTERFACE_NAME
    string "Device interface name"
    default "COM Port"

endmenu


# --------------------------------------------------------------------------
# Debug settings
# --------------------------------------------------------------------------

choice 
    prompt "TinyUSB Log Level"
    default TLK_USB_NO_LOG

config TLK_USB_NO_LOG
    bool "Disable TinyUSB logs"

config TLK_USB_ERROR_LOG
    bool "Enable TinyUSB error logs"

config TLK_USB_WARNING_LOG
    bool "Enable TinyUSB warning and error logs"

config TLK_USB_INFO_LOG
    bool "Enable TinyUSB error, warning and info logs"

endchoice # TinyUSB Log Level

config TLK_USB_LOG_LEVEL
    int
    default 0 if TLK_USB_NO_LOG
    default 1 if TLK_USB_ERROR_LOG
    default 2 if TLK_USB_WARNING_LOG
    default 3 if TLK_USB_INFO_LOG

config TLK_USB_LOG_PHY
    def_bool y
    depends on TLK_USB_LOG_LEVEL > 0
    select TLK_CRITICAL_PRINTOUT


# --------------------------------------------------------------------------
# СDC settings
# --------------------------------------------------------------------------
if TLK_USB_CLASS_CDC
menu "CDC ACM settings"

config TLK_USB_CDC_RX_BUF_SIZE
    int "Size of the receive buffer for CDC ACM"
    default 64

config TLK_USB_CDC_TX_BUF_SIZE
    int "Size of the transmit buffer for CDC ACM"
    default 64


config TLK_USB_CDC_NOTIF_EP
    hex "Endpoint address for notification channel"
    default 0x81

config TLK_USB_CDC_OUT_EP
    hex "Endpoint address for OUT transfers"
    default 0x05

config TLK_USB_CDC_IN_EP
    hex "Endpoint address for IN transfers"
    default 0x82

endmenu
endif # TLK_USB_CLASS_CDC


endmenu
```

## kconfig/TLSR952X/Kconfig.uart
```kconfig
menuconfig TLK_UART
    bool "UART"
    select TLK_GPIO
    select TLK_PLIC      # For basic UART RX
    select TLK_API_TIME  # For basic UART TX


if TLK_UART

# Global TLK_UART configs
config TLK_UART_USED_BLOCKING
    bool

config TLK_UART_USED_IRQ
    bool

config TLK_UART_USED_DMA
    bool


config TLK_UART_USED_AUTO_CONFIG
    bool

config TLK_UART_USED_PM_DEVICE
    bool

config TLK_UART_USED_FLOW_CONTROL
    bool



# Global TLK_UART0 configs
config TLK_UART0_USED_IRQ
    bool
    select TLK_UART_USED_IRQ

config TLK_UART0_USED_DMA
    bool
    select TLK_UART_USED_DMA


menuconfig TLK_UART0_ENABLED
    bool "Enable UART0"


if TLK_UART0_ENABLED

menuconfig TLK_UART0_AUTO_CONFIG
    bool "Configure automatically"
    select TLK_UART_USED_AUTO_CONFIG


if TLK_UART0_AUTO_CONFIG

config TLK_UART0_BAUDRATE
    int "Baudrate"
    default 115200


choice
    prompt "Parity"
    default TLK_UART0_PARITY_NONE

config TLK_UART0_PARITY_NONE
    bool "None"

config TLK_UART0_PARITY_EVEN
    bool "Even"

config TLK_UART0_PARITY_ODD
    bool "Odd"

endchoice # Parity


config TLK_UART0_PARITY
    string
    default "TLK_UART_PARITY_NONE" if TLK_UART0_PARITY_NONE
    default "TLK_UART_PARITY_EVEN" if TLK_UART0_PARITY_EVEN
    default "TLK_UART_PARITY_ODD" if TLK_UART0_PARITY_ODD


choice
    prompt "Stop bit"
    default TLK_UART0_STOP_BIT_ONE

config TLK_UART0_STOP_BIT_ONE
    bool "One"

config TLK_UART0_STOP_BIT_ONE_DOT_FIVE
    bool "One dot five"

config TLK_UART0_STOP_BIT_TWO
    bool "Two"

endchoice # Stop bit


config TLK_UART0_STOP_BIT
    string
    default "TLK_UART_STOP_BIT_ONE" if TLK_UART0_STOP_BIT_ONE
    default "TLK_UART_STOP_BIT_ONE_DOT_FIVE" if TLK_UART0_STOP_BIT_ONE_DOT_FIVE
    default "TLK_UART_STOP_BIT_TWO" if TLK_UART0_STOP_BIT_TWO


if TLK_UART0_FLOW_CONTROL

# Global TLK_UART0_FLOW_CONTROL configs
config TLK_UART0_FLOW_CONTROL_USED_RTS
    bool

config TLK_UART0_FLOW_CONTROL_USED_CTS
    bool


choice
    prompt "Flow control"
    default TLK_UART0_FLOW_CONTROL_NONE

config TLK_UART0_FLOW_CONTROL_NONE
    bool "None"

config TLK_UART0_FLOW_CONTROL_RTS
    bool "RTS"
    select TLK_UART0_FLOW_CONTROL_USED_RTS

config TLK_UART0_FLOW_CONTROL_CTS
    bool "CTS"
    select TLK_UART0_FLOW_CONTROL_USED_CTS

config TLK_UART0_FLOW_CONTROL_RTS_CTS
    bool "RTS_CTS"
    select TLK_UART0_FLOW_CONTROL_USED_RTS
    select TLK_UART0_FLOW_CONTROL_USED_CTS

endchoice # Flow control


config TLK_UART0_FLOW_CONTROL_TYPE
    string
    default "TLK_UART_FLOW_NONE" if TLK_UART0_FLOW_CONTROL_NONE
    default "TLK_UART_FLOW_RTS" if TLK_UART0_FLOW_CONTROL_RTS
    default "TLK_UART_FLOW_CTS" if TLK_UART0_FLOW_CONTROL_CTS
    default "TLK_UART_FLOW_RTS_CTS" if TLK_UART0_FLOW_CONTROL_RTS_CTS


choice
    prompt "Flow polarity"
    default TLK_UART0_FLOW_POLARITY_LOW

config TLK_UART0_FLOW_POLARITY_LOW
    bool "Low"

config TLK_UART0_FLOW_POLARITY_HIGH
    bool "High"

endchoice # Flow polarity


config TLK_UART0_FLOW_POLARITY
    string
    default "TLK_UART_ACTIVE_LOW" if TLK_UART0_FLOW_POLARITY_LOW
    default "TLK_UART_ACTIVE_HIGH" if TLK_UART0_FLOW_POLARITY_HIGH

endif # TLK_UART0_FLOW_CONTROL

endif # UART0_AUTO_CONFIG


choice
    prompt "TX mode"
    default TLK_UART0_TX_BLOCKING

config TLK_UART0_TX_BLOCKING
    bool "Blocking"
    select TLK_UART_USED_BLOCKING

config TLK_UART0_TX_IRQ
    bool "Interrupt"
    select TLK_UART0_USED_IRQ
    depends on TLK_PLIC

config TLK_UART0_TX_DMA
    bool "DMA"
    select TLK_UART0_USED_DMA
    select TLK_UART0_USED_IRQ
    depends on TLK_DMA
    depends on TLK_PLIC

endchoice # TX mode


config TLK_UART0_TX_MODE
    string
    default "TLK_UART_XFER_BLOCKING" if TLK_UART0_TX_BLOCKING
    default "TLK_UART_XFER_IRQ" if TLK_UART0_TX_IRQ
    default "TLK_UART_XFER_DMA" if TLK_UART0_TX_DMA


choice
    prompt "RX mode"
    default TLK_UART0_RX_IRQ

config TLK_UART0_RX_IRQ
    bool "Interrupt"
    select TLK_UART0_USED_IRQ

config TLK_UART0_RX_DMA
    bool "DMA"
    select TLK_UART0_USED_DMA
    select TLK_UART0_USED_IRQ
    depends on TLK_DMA
    depends on TLK_PLIC

endchoice # RX mode


config TLK_UART0_RX_MODE
    string
    default "TLK_UART_XFER_BLOCKING" if TLK_UART0_RX_BLOCKING
    default "TLK_UART_XFER_IRQ" if TLK_UART0_RX_IRQ
    default "TLK_UART_XFER_DMA" if TLK_UART0_RX_DMA


if TLK_UART0_RX_DMA

choice
    prompt "RX DMA type"

config TLK_UART0_RX_DMA_FIXED
    bool "Word only"

config TLK_UART0_RX_DMA_WITH_TAIL
    bool "Word with manual tail read"
    depends on TLK_DMA_IRQ_HANDLER

endchoice # RX DMA type


config TLK_UART0_RX_DMA_MODE
    string
    default "TLK_UART_RX_DMA_FIXED" if TLK_UART0_RX_DMA_FIXED
    default "TLK_UART_RX_DMA_WITH_TAIL" if TLK_UART0_RX_DMA_WITH_TAIL

endif # TLK_UART0_RX_DMA


config TLK_UART0_FLOW_CONTROL
    bool "Use flow control"
    select TLK_UART_USED_FLOW_CONTROL


config TLK_RTS_TRIG_LEVEL
   int "RTS trig level"
   default 5
   range 1 8
   depends on TLK_UART0_FLOW_CONTROL


if TLK_PM

config TLK_UART0_PM_DEVICE
    bool "Enable PM Support"
    default y
    select TLK_UART_USED_PM_DEVICE

config TLK_UART0_PREVENT_SLEEP
    bool "Prevent sleep if busy"

endif # TLK_PM

endif # TLK_UART0_ENABLED

# Global TLK_UART1 configs
config TLK_UART1_USED_IRQ
    bool
    select TLK_UART_USED_IRQ

config TLK_UART1_USED_DMA
    bool
    select TLK_UART_USED_DMA


menuconfig TLK_UART1_ENABLED
    bool "Enable UART1"


if TLK_UART1_ENABLED

menuconfig TLK_UART1_AUTO_CONFIG
    bool "Configure automatically"
    select TLK_UART_USED_AUTO_CONFIG


if TLK_UART1_AUTO_CONFIG

config TLK_UART1_BAUDRATE
    int "Baudrate"
    default 115200


choice
    prompt "Parity"
    default TLK_UART1_PARITY_NONE

config TLK_UART1_PARITY_NONE
    bool "None"

config TLK_UART1_PARITY_EVEN
    bool "Even"

config TLK_UART1_PARITY_ODD
    bool "Odd"

endchoice # Parity


config TLK_UART1_PARITY
    string
    default "TLK_UART_PARITY_NONE" if TLK_UART1_PARITY_NONE
    default "TLK_UART_PARITY_EVEN" if TLK_UART1_PARITY_EVEN
    default "TLK_UART_PARITY_ODD" if TLK_UART1_PARITY_ODD


choice
    prompt "Stop bit"
    default TLK_UART1_STOP_BIT_ONE

config TLK_UART1_STOP_BIT_ONE
    bool "One"

config TLK_UART1_STOP_BIT_ONE_DOT_FIVE
    bool "One dot five"

config TLK_UART1_STOP_BIT_TWO
    bool "Two"

endchoice # Stop bit


config TLK_UART1_STOP_BIT
    string
    default "TLK_UART_STOP_BIT_ONE" if TLK_UART1_STOP_BIT_ONE
    default "TLK_UART_STOP_BIT_ONE_DOT_FIVE" if TLK_UART1_STOP_BIT_ONE_DOT_FIVE
    default "TLK_UART_STOP_BIT_TWO" if TLK_UART1_STOP_BIT_TWO


if TLK_UART1_FLOW_CONTROL

# Global TLK_UART1_FLOW_CONTROL configs
config TLK_UART1_FLOW_CONTROL_USED_RTS
    bool

config TLK_UART1_FLOW_CONTROL_USED_CTS
    bool


choice
    prompt "Flow control"
    default TLK_UART1_FLOW_CONTROL_NONE

config TLK_UART1_FLOW_CONTROL_NONE
    bool "None"

config TLK_UART1_FLOW_CONTROL_RTS
    bool "RTS"
    select TLK_UART1_FLOW_CONTROL_USED_RTS

config TLK_UART1_FLOW_CONTROL_CTS
    bool "CTS"
    select TLK_UART1_FLOW_CONTROL_USED_CTS

config TLK_UART1_FLOW_CONTROL_RTS_CTS
    bool "RTS_CTS"
    select TLK_UART1_FLOW_CONTROL_USED_RTS
    select TLK_UART1_FLOW_CONTROL_USED_CTS

endchoice # Flow control


config TLK_UART1_FLOW_CONTROL_TYPE
    string
    default "TLK_UART_FLOW_NONE" if TLK_UART1_FLOW_CONTROL_NONE
    default "TLK_UART_FLOW_RTS" if TLK_UART1_FLOW_CONTROL_RTS
    default "TLK_UART_FLOW_CTS" if TLK_UART1_FLOW_CONTROL_CTS
    default "TLK_UART_FLOW_RTS_CTS" if TLK_UART1_FLOW_CONTROL_RTS_CTS


choice
    prompt "Flow polarity"
    default TLK_UART1_FLOW_POLARITY_LOW

config TLK_UART1_FLOW_POLARITY_LOW
    bool "Low"

config TLK_UART1_FLOW_POLARITY_HIGH
    bool "High"

endchoice # Flow polarity


config TLK_UART1_FLOW_POLARITY
    string
    default "TLK_UART_ACTIVE_LOW" if TLK_UART1_FLOW_POLARITY_LOW
    default "TLK_UART_ACTIVE_HIGH" if TLK_UART1_FLOW_POLARITY_HIGH

endif # TLK_UART1_FLOW_CONTROL

endif # UART1_AUTO_CONFIG


choice
    prompt "TX mode"
    default TLK_UART1_TX_BLOCKING

config TLK_UART1_TX_BLOCKING
    bool "Blocking"
    select TLK_UART_USED_BLOCKING

config TLK_UART1_TX_IRQ
    bool "Interrupt"
    select TLK_UART1_USED_IRQ
    depends on TLK_PLIC

config TLK_UART1_TX_DMA
    bool "DMA"
    select TLK_UART1_USED_DMA
    select TLK_UART1_USED_IRQ
    depends on TLK_DMA
    depends on TLK_PLIC

endchoice # TX mode


config TLK_UART1_TX_MODE
    string
    default "TLK_UART_XFER_BLOCKING" if TLK_UART1_TX_BLOCKING
    default "TLK_UART_XFER_IRQ" if TLK_UART1_TX_IRQ
    default "TLK_UART_XFER_DMA" if TLK_UART1_TX_DMA


choice
    prompt "RX mode"
    default TLK_UART1_RX_IRQ

config TLK_UART1_RX_IRQ
    bool "Interrupt"
    select TLK_UART1_USED_IRQ

config TLK_UART1_RX_DMA
    bool "DMA"
    select TLK_UART1_USED_DMA
    select TLK_UART1_USED_IRQ
    depends on TLK_DMA
    depends on TLK_PLIC

endchoice # RX mode


config TLK_UART1_RX_MODE
    string
    default "TLK_UART_XFER_BLOCKING" if TLK_UART1_RX_BLOCKING
    default "TLK_UART_XFER_IRQ" if TLK_UART1_RX_IRQ
    default "TLK_UART_XFER_DMA" if TLK_UART1_RX_DMA


if TLK_UART1_RX_DMA

choice
    prompt "RX DMA type"

config TLK_UART1_RX_DMA_FIXED
    bool "Word only"

config TLK_UART1_RX_DMA_WITH_TAIL
    bool "Word with manual tail read"
    depends on TLK_DMA_IRQ_HANDLER

endchoice # RX DMA type


config TLK_UART1_RX_DMA_MODE
    string
    default "TLK_UART_RX_DMA_FIXED" if TLK_UART1_RX_DMA_FIXED
    default "TLK_UART_RX_DMA_WITH_TAIL" if TLK_UART1_RX_DMA_WITH_TAIL

endif # TLK_UART1_RX_DMA


config TLK_UART1_FLOW_CONTROL
    bool "Use flow control"
    select TLK_UART_USED_FLOW_CONTROL


config TLK_RTS_TRIG_LEVEL
   int "RTS trig level"
   default 5
   range 1 8
   depends on TLK_UART1_FLOW_CONTROL


if TLK_PM

config TLK_UART1_PM_DEVICE
    bool "Enable PM Support"
    default y
    select TLK_UART_USED_PM_DEVICE

config TLK_UART1_PREVENT_SLEEP
    bool "Prevent sleep if busy"

endif # TLK_PM

endif # TLK_UART1_ENABLED

endif # TLK_UART
```

## kconfig/TLSR952X/Kconfig.uart_demo
```kconfig
config TLK_UART_DEMO
    def_bool y
    select TLK_UART


menu "UART Sample configuration"

# UART Selection
choice
    prompt "UART number"

config TLK_UART_DEMO_UART0
    bool "UART0"
    select TLK_UART0_ENABLED
config TLK_UART_DEMO_UART1
    bool "UART1"
    select TLK_UART1_ENABLED

endchoice # UART number


# Selected UART 
config TLK_UART_DEMO_UART
    string
    default TLK_UART0 if TLK_UART_DEMO_UART0
    default TLK_UART1 if TLK_UART_DEMO_UART1


# Selected UART autoconfig check
config TLK_UART_DEMO_AUTO_CONFIG
    bool
    default y if (TLK_UART_DEMO_UART0 && TLK_UART0_AUTO_CONFIG)
    default y if (TLK_UART_DEMO_UART1 && TLK_UART1_AUTO_CONFIG)


# Buffer size
config TLK_UART_DEMO_BUFFER_SIZE
    int "Buffer size"
    default 15


# Demo configs
config TLK_UART_DEMO_SLEEP
    bool "UART demo with sleep"
    select TLK_API_SLEEP
    imply TLK_UART0_PM_DEVICE if TLK_UART_DEMO_UART0
    imply TLK_UART1_PM_DEVICE if TLK_UART_DEMO_UART1
    
config TLK_UART_DEMO_PREVENT
    bool "UART demo with prevent"
    select TLK_PM
    select TLK_PM_SUSPEND
    select TLK_UART0_PREVENT_SLEEP if TLK_UART_DEMO_UART0
    select TLK_UART1_PREVENT_SLEEP if TLK_UART_DEMO_UART1

endmenu
```

## kconfig/TLSR952X/TLSR9528A_EVK/core/configs/Kconfig.common
```kconfig
menuconfig TLK_CRITICAL_PRINTOUT
    bool "Enable critical printout"
    select TLK_UART


if TLK_CRITICAL_PRINTOUT

# UART Selection
choice
    prompt "UART number"

config TLK_CRITICAL_UART0_ENABLED
    bool "UART0"
    select TLK_UART0_ENABLED
config TLK_CRITICAL_UART1_ENABLED
    bool "UART1"
    select TLK_UART1_ENABLED

endchoice # UART number


# Selected UART
config TLK_CRITICAL_UART
    string
    default TLK_UART0 if TLK_CRITICAL_UART0_ENABLED
    default TLK_UART1 if TLK_CRITICAL_UART1_ENABLED


# Baudrate
config TLK_CRITICAL_UART_BAUDRATE
    int "Baudrate"
    default 115200

endif # TLK_CRITICAL_PRINTOUT

##############################################################

config TLK_BINARY_SIGNATURE_ADDRESS
    hex
    default 0x100

config TLK_BINARY_SIGNATURE_CORE_NAME_SIZE
    int
    default 16

config TLK_BINARY_SIGNATURE_SOC_NAME_SIZE
    int
    default 16

config TLK_BINARY_SIGNATURE_SOC_CASE_NAME_SIZE
    int
    default 16

config TLK_BINARY_SIGNATURE_SDK_VERSION_SIZE
    int
    default 48

config TLK_BINARY_SIGNATURE_APP_VERSION_SIZE
    int
    default 48
```

## kconfig/TLSR952X/TLSR9528A_EVK/core/configs/Kconfig.i2s
```kconfig
menuconfig TLK_I2S
    bool "I2S"
    select TLK_GPIO
    select TLK_DMA

if TLK_I2S


menuconfig TLK_I2S0
    bool "I2S0"

menuconfig TLK_I2S1
    bool "I2S1"

endif # TLK_I2S
```

## kconfig/TLSR952X/TLSR9528A_EVK/core/configs/Kconfig.wdt
```kconfig
menuconfig TLK_WDT
    bool "WDT"
    select TLK_SYSTEM_TIMER_ADVANCED_MODE


if TLK_WDT

config TLK_WDT_STARTUP_ENABLE
    bool "Enable WDT at startup"

config TLK_WDT_STARTUP_TIMEOUT
    int "WDT startup timeout (ms)"
    depends on TLK_WDT_STARTUP_ENABLE
    default 5000

endif # TLK_WDT
```
