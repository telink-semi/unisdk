## kconfig/TL721X/TL7218X_EVK/core/configs/Kconfig.i2s
```kconfig
menuconfig TLK_I2S
    bool "I2S"
    select TLK_GPIO
    select TLK_DMA

if TLK_I2S


menuconfig TLK_I2S0
    bool "I2S0"

menuconfig TLK_I2S1
    bool "I2S1"

menuconfig TLK_I2S2
    bool "I2S2"

endif # TLK_I2S
```

## kconfig/TL721X/TL7218X_EVK/core/configs/Kconfig.rf
```kconfig
menuconfig TLK_RF
    bool "RF"
    select TLK_DMA
    select TLK_PLIC


if TLK_RF

config TLK_RF_RX_SHORT_MODE
    bool "RX short mode"
    default y

config TLK_RF_TX_HPMC_COMPENSATION
    bool "TX HPMC compensation"
    default y

config TLK_RF_LDO_PLL_COMPENSATION
    bool "LDO PLL compensation"
    default y

config TLK_RF_RX_DCOC_SW_CALIBRATION
    bool "RX DCOC SW calibration"
    default y

config TLK_RF_PM_DEVICE
    bool "Enable PM support"
    depends on TLK_PM
    default y

endif # TLK_RF
```

## kconfig/TL721X/TL7218X_EVK/samples/ble_controller_demo/Kconfig
```kconfig
config TLK_BLE_CONTROLLER_DEMO
    def_bool y
    select TLK_UART
    select TLK_UART1_ENABLED
    select TLK_RF
    select TLK_BLE_CONTROLLER

config TLK_BLE_CONTROLLER_HCI_ACL_DATA_SIZE
    def_int 50

config TLK_BLE_CONTROLLER_HCI_ACL_BUFFER_COUNT
    def_int 10

config TLK_BLE_CONTROLLER_ACCEPT_LIST_ENABLE
    def_bool y

config TLK_BLE_CONTROLLER_RESOLVING_LIST_ENABLE
    def_bool y

config TLK_BLE_CONTROLLER_LEGACY_ADV_ENABLE
    def_bool y

config TLK_BLE_CONTROLLER_LEGACY_SCAN_ENABLE
    def_bool y

config TLK_BLE_CONTROLLER_ACL_PERIPHERAL_ENABLE
    def_bool y

config TLK_BLE_CONTROLLER_ACL_PERIPHERAL_MAX_NUM
    def_int 1

config TLK_BLE_CONTROLLER_ACL_CENTRAL_ENABLE
    def_bool y

config TLK_BLE_CONTROLLER_ACL_CENTRAL_MAX_NUM
    def_int 1

config TLK_BLE_CONTROLLER_ACL_RX_MAX_LENGTH
    def_int 27
```

## kconfig/TL721X/TL7218X_EVK/samples/ble_host_demo/Kconfig
```kconfig
config TLK_BLE_HOST_V2_DEMO
    def_bool y
    select TLK_BLE_HOST_V2
    select TLK_BLE_CONTROLLER
```

## kconfig/TL721X/TL7218X_EVK/samples/pm_demo/Kconfig
```kconfig
config TLK_PM_DEMO
    def_bool y
    select TLK_API_TIME
    select TLK_API_SLEEP
    select TLK_PM
    select TLK_PM_DEEP_SLEEP
    select TLK_PM_RAM_RETENTION_ENABLE
    select TLK_PM_DEMO_ENABLE_LED


menu "PM Demo Configuration"

config TLK_PM_DEMO_ENABLE_GPIO_INPUT
    bool "PM demo with GPIO input"
    select TLK_GPIO

config TLK_PM_DEMO_ENABLE_LED
    bool "PM demo with LED"
    select TLK_GPIO

config TLK_PM_DEMO_DISABLE_LED_BEFORE_SLEEP
    bool "Disable LED before sleep"
    depends on TLK_PM_DEMO_ENABLE_LED

endmenu

config TLK_BLE_CONTROLLER
    default n
```

## kconfig/TL721X/TL7218X_EVK/samples/wdt_demo/Kconfig
```kconfig
config TLK_WDT_DEMO
    def_bool y
    select TLK_WDT
    select TLK_API_TIME

menu "WDT Sample configuration"

config TLK_WDT_DEMO_GPIO_INDICATION
    bool "WDT GPIO indication"
    select TLK_GPIO

config TLK_WDT_DEMO_PM
    bool "WDT with PM"
    select TLK_API_SLEEP
    select TLK_PM

config TLK_WDT_DEMO_STARTUP
    bool "Start WDT from startup code"
    select TLK_WDT_STARTUP_ENABLE

endmenu
```

## kconfig/TLSR952X/Kconfig
```kconfig
osource "$(KCONFIG_BINARY_DIR)/Kconfig.debug" # TODO: Explore how we can script all Kconfig files where ${...} inserts or for are possible, which are currently processed via preprocess_kconfig.py
osource "$(KCONFIG_BINARY_DIR)/Kconfig.task_planner" # TODO: Explore how we can script all Kconfig files where ${...} inserts or for are possible, which are currently processed via preprocess_kconfig.py


menu "SoC configuration"

# Stack size in retention memory
config TLK_MEMORY_STACK_SIZE
    int "Stack size in Kbytes"
    default 4
    range 1 16 if TLK_PM_RETENTION_MEMORY_SIZE_32K
    range 1 32 if TLK_PM_RETENTION_MEMORY_SIZE_64K
    range 1 64 if TLK_PM_RETENTION_MEMORY_SIZE_96K
    range 1 96 if TLK_PM_RETENTION_MEMORY_SIZE_128K
    range 1 128 if TLK_PM_RETENTION_MEMORY_SIZE_192K
    range 1 192 if TLK_PM_RETENTION_MEMORY_SIZE_256K
    range 1 96

config ALLOW_DYNAMIC_MEMORY_ALLOCATION
    bool "Allow dynamic memory allocation"
    default n
    help
        If you want to use dynamic memory allocators in system predefined retention heap, 
        you have to enable this config.

endmenu


menu "Other configuration"

# Allow CPP wrappers for C++ builds
config TLK_ALLOW_CPP_WRAPPERS
    bool "Allow CPP wrappers"


# Compiler optimization level selection
choice
    prompt "Optimization level"
    default TLK_OPTIMIZATION_LEVEL_O2

config TLK_OPTIMIZATION_LEVEL_O0
    bool "O0"

config TLK_OPTIMIZATION_LEVEL_O1
    bool "O1"

config TLK_OPTIMIZATION_LEVEL_O2
    bool "O2"

config TLK_OPTIMIZATION_LEVEL_O3
    bool "O3"

config TLK_OPTIMIZATION_LEVEL_OS
    bool "Os"

config TLK_OPTIMIZATION_LEVEL_OFAST
    bool "Ofast"

endchoice # Optimization level


# Selected optimization level string
config TLK_OPTIMIZATION_LEVEL
    string
    default "O0" if TLK_OPTIMIZATION_LEVEL_O0
    default "O1" if TLK_OPTIMIZATION_LEVEL_O1
    default "O2" if TLK_OPTIMIZATION_LEVEL_O2
    default "O3" if TLK_OPTIMIZATION_LEVEL_O3
    default "Os" if TLK_OPTIMIZATION_LEVEL_OS
    default "Ofast" if TLK_OPTIMIZATION_LEVEL_OFAST

endmenu


menu "Subsystems"

rsource "storage/Kconfig.nv_storage"

if TLK_USB
    rsource "Kconfig.tinyusb"
endif

endmenu
```

## kconfig/TLSR952X/Kconfig.common
```kconfig
menuconfig TLK_CRITICAL_PRINTOUT
    bool "Enable critical printout"
    select TLK_UART


if TLK_CRITICAL_PRINTOUT

# UART Selection
choice
    prompt "UART number"

config TLK_CRITICAL_UART0_ENABLED
    bool "UART0"
    select TLK_UART0_ENABLED
config TLK_CRITICAL_UART1_ENABLED
    bool "UART1"
    select TLK_UART1_ENABLED

endchoice # UART number


# Selected UART
config TLK_CRITICAL_UART
    string
    default TLK_UART0 if TLK_CRITICAL_UART0_ENABLED
    default TLK_UART1 if TLK_CRITICAL_UART1_ENABLED


# Baudrate
config TLK_CRITICAL_UART_BAUDRATE
    int "Baudrate"
    default 115200

endif # TLK_CRITICAL_PRINTOUT
```

## kconfig/TLSR952X/Kconfig.debug
```kconfig
menu "Debug configuration"

# Stack painting for debug purposes
config TLK_STACK_STATISTIC
    bool "Stack painting for debug"


# Debug interfaces top-level enable
menuconfig TLK_DEBUG_INTERFACES
    bool "Enable debug interfaces"

if TLK_DEBUG_INTERFACES

# SWS debug interface
config TLK_DEBUG_SWS
    bool "Enable SWS interface"
    select TLK_GPIO

# JTAG debug interface
config TLK_DEBUG_JTAG
    bool "Enable JTAG interface"
    select TLK_GPIO

# GPIO debug interface
config TLK_DEBUG_GPIO
    bool "Enable GPIO debug interface"

endif # TLK_DEBUG_INTERFACES


# Log console top-level enable
menuconfig TLK_DEBUG_LOG_CONSOLE
    bool "Enable console debug interface"
    select TLK_MTIMER

if TLK_DEBUG_LOG_CONSOLE

# Enable ctrl command reception from host
config TLK_DEBUG_LOG_CONSOLE_ENABLE_CTRL_CALLBACK
    bool "Enable ctrl command reception from host"


# Debug log ring buffer size
config TLK_DEBUG_LOG_BUFFER_SIZE
    int "Debug log buffer size"
    default 256

# Allow logging from ISR context
config TLK_DEBUG_LOG_FROM_ISR
    bool "Print log from ISR"
    depends on TLK_PLIC


# Log output interface selection
choice
    prompt "Debug Log interface"
    default TLK_DEBUG_LOG_INTERFACE_NONE

config TLK_DEBUG_LOG_INTERFACE_UART
    bool "UART"
    select TLK_UART

config TLK_DEBUG_LOG_INTERFACE_USB_CDC
    bool "USB CDC"
    select TLK_USB

config TLK_DEBUG_LOG_INTERFACE_NONE
    bool "None"

endchoice # Debug Log interface


if TLK_DEBUG_LOG_INTERFACE_UART

# UART instance selection for log output
choice
    prompt "Debug UART number"

config TLK_DEBUG_LOG_UART0
    bool "UART0"
    select TLK_UART0_ENABLED
    select TLK_UART0_AUTO_CONFIG
    imply TLK_UART0_PM_DEVICE
config TLK_DEBUG_LOG_UART1
    bool "UART1"
    select TLK_UART1_ENABLED
    select TLK_UART1_AUTO_CONFIG
    imply TLK_UART1_PM_DEVICE

endchoice # UART number


# Selected UART instance
config TLK_DEBUG_UART
    string
    default "TLK_UART0" if TLK_DEBUG_LOG_UART0
    default "TLK_UART1" if TLK_DEBUG_LOG_UART1

endif # TLK_DEBUG_LOG_INTERFACE_UART


# Log verbosity level selection
choice
    prompt "Debug Log Level"
    default TLK_DEBUG_LOG_LEVEL_NONE

config TLK_DEBUG_LOG_LEVEL_NONE
    bool "None"

config TLK_DEBUG_LOG_LEVEL_ERROR
    bool "Error"

config TLK_DEBUG_LOG_LEVEL_WARN
    bool "Warn"

config TLK_DEBUG_LOG_LEVEL_INFO
    bool "Info"

config TLK_DEBUG_LOG_LEVEL_DEBUG
    bool "Debug"

endchoice # Debug Log Level


# Selected log level numeric value
config TLK_DEBUG_LOG_LEVEL
    int
    default 0 if TLK_DEBUG_LOG_LEVEL_NONE
    default 1 if TLK_DEBUG_LOG_LEVEL_ERROR
    default 2 if TLK_DEBUG_LOG_LEVEL_WARN
    default 3 if TLK_DEBUG_LOG_LEVEL_INFO
    default 4 if TLK_DEBUG_LOG_LEVEL_DEBUG


# Log output priority selection
choice
    prompt "Debug Log Priority"
    default TLK_DEBUG_LOG_PRIO_IMMEDIATE

config TLK_DEBUG_LOG_PRIO_HIGH
    bool "High priority (ring buffer + timer)"
    depends on TLK_SOFTWARE_TIMERS
    depends on TLK_PLIC

config TLK_DEBUG_LOG_PRIO_LOW
    bool "Low priority (ring buffer)"

config TLK_DEBUG_LOG_PRIO_IMMEDIATE
    bool "Immediate (blocking mode)"

endchoice # Debug Log Priority


# Ring buffer queue depth for buffered modes
config TLK_DEBUG_LOG_QUEUE_SIZE
    int "Debug Log Queue size"
    default 50
    depends on TLK_DEBUG_LOG_PRIO_LOW || TLK_DEBUG_LOG_PRIO_HIGH

# Periodic pump interval for high priority mode
config TLK_DEBUG_LOG_PERIODIC_PUMP_PERIOD
    int "Debug Log Pump period [ms]"
    default 200
    depends on TLK_DEBUG_LOG_PRIO_HIGH || TLK_TASK_PLANNER_MODE_SCHEDULER

endif # TLK_DEBUG_LOG_CONSOLE


# Assert top-level enable
menuconfig TLK_DEBUG_ASSERT
    bool "Enable debug assert"

if TLK_DEBUG_ASSERT

# MCU reaction on assert
choice
    prompt "Assert MCU action"
    default TLK_DEBUG_ASSERT_MCU_MODE_REBOOT

config TLK_DEBUG_ASSERT_MCU_MODE_REBOOT
    bool "Reboot"

config TLK_DEBUG_ASSERT_MCU_MODE_STALL
    bool "Stall"

config TLK_DEBUG_ASSERT_MCU_MODE_DEEP_SLEEP
    bool "Deep Sleep"
    depends on TLK_PM_DEEP_SLEEP

endchoice # Assert MCU action

endif # TLK_DEBUG_ASSERT

endmenu
```

## kconfig/TLSR952X/Kconfig.mtimer
```kconfig
menuconfig TLK_MTIMER
    bool "MTIMER"


if TLK_MTIMER

menuconfig TLK_MTIMER_IRQ_ENABLE
    bool "Enable interrupts"


if TLK_MTIMER_IRQ_ENABLE

config TLK_MTIMER_IRQ_NEST_SELECTED
    bool
    default n


config TLK_MTIMER_IRQ_NEST_PLIC_SW
    bool "Nest machine software interrupt (MSIE)"
    select TLK_MTIMER_IRQ_NEST_SELECTED
    depends on TLK_PLIC_SW


config TLK_MTIMER_IRQ_NEST_PLIC
    bool "Nest external interrupts (MEIE)"
    select TLK_MTIMER_IRQ_NEST_SELECTED
    depends on TLK_PLIC

endif # TLK_MTIMER_IRQ_ENABLE

endif # TLK_MTIMER
```

## kconfig/TLSR952X/Kconfig.plic
```kconfig
menuconfig TLK_PLIC
    bool "PLIC"


if TLK_PLIC

config TLK_PLIC_VECTOR_MODE
    bool "Enable vector mode"
    default y


menu "Interrupts nesting"

config TLK_PLIC_NEST_SELECTED
    bool
    default n


config TLK_PLIC_NEST_PLIC_SW
    bool "Nest machine software interrupt (MSIE)"
    select TLK_PLIC_NEST_SELECTED
    depends on TLK_PLIC_SW


config TLK_PLIC_NEST_MTIMER
    bool "Nest machine timer interrupt (MTIE)"
    select TLK_PLIC_NEST_SELECTED
    depends on TLK_MTIMER_IRQ_ENABLE


config TLK_PLIC_NEST_PLIC
    bool "Nest external interrupts (MEIE)"
    select TLK_PLIC_NEST_SELECTED

endmenu

endif # TLK_PLIC
```

## kconfig/TLSR952X/Kconfig.plicsw
```kconfig
menuconfig TLK_PLIC_SW
    bool "SW PLIC"
    

if TLK_PLIC_SW

config TLK_PLIC_SW_ENABLE_NESTING
    bool "Enable nesting into the software interrupt"

endif # TLK_PLIC_SW
```
