## Kconfig.build
```kconfig
osource "$(KCONFIG_APPLICATION_DIR)/Kconfig"
rsource "core/api/Kconfig"
rsource "core/configs/Kconfig"
rsource "modules/Kconfig"
rsource "system/Kconfig"
rsource "subsystem/Kconfig"
```

## Kconfig.chip
```kconfig
config TLK_HAS_BGA56_CASE
    bool

config TLK_HAS_BGA94_CASE
    bool

config TLK_HAS_LGA42_CASE
    bool

config TLK_HAS_QFN28_CASE
    bool

config TLK_HAS_QFN32_CASE
    bool

config TLK_HAS_QFN38_CASE
    bool

config TLK_HAS_QFN40_CASE
    bool

config TLK_HAS_QFN48_CASE
    bool

config TLK_HAS_QFN52_CASE
    bool

config TLK_HAS_QFN56_CASE
    bool

config TLK_HAS_QFN64_CASE
    bool

config TLK_HAS_QFN68_CASE
    bool

config TLK_HAS_QFN88_CASE
    bool

config TLK_CASE
    string
    default "BGA56" if TLK_HAS_BGA56_CASE
    default "BGA94" if TLK_HAS_BGA94_CASE
    default "LGA42" if TLK_HAS_LGA42_CASE
    default "QFN28" if TLK_HAS_QFN28_CASE
    default "QFN32" if TLK_HAS_QFN32_CASE
    default "QFN38" if TLK_HAS_QFN38_CASE
    default "QFN40" if TLK_HAS_QFN40_CASE
    default "QFN48" if TLK_HAS_QFN48_CASE
    default "QFN52" if TLK_HAS_QFN52_CASE
    default "QFN56" if TLK_HAS_QFN56_CASE
    default "QFN64" if TLK_HAS_QFN64_CASE
    default "QFN68" if TLK_HAS_QFN68_CASE
    default "QFN88" if TLK_HAS_QFN88_CASE

# MCU packages Kconfig files
rsource "packages/Kconfig.mcu"
```

## api/Kconfig
```kconfig
menu "API configuration"

config TLK_API_TIME
    bool "Enable time API"


if !TLK_TASK_PLANNER && !TLK_SOFTWARE_TIMERS

config TLK_API_SLEEP
    bool "Enable sleep API"
    select TLK_MTIMER
    select TLK_MTIMER_IRQ_ENABLE

endif # !TLK_TASK_PLANNER && !TLK_SOFTWARE_TIMERS

endmenu
```

## boards/Kconfig
```kconfig
config TLK_HAS_BOARD_SELECTED
    bool


choice
    prompt "Board"
    optional

config TLK_BOARD_TL3218X_EVK
    depends on TLK_SOC_TL3218X
    bool "TL3218X_EVK"
    select TLK_HAS_BOARD_SELECTED

config TLK_BOARD_TL7218X_EVK
    depends on TLK_SOC_TL7218X
    bool "TL7218X_EVK"
    select TLK_HAS_BOARD_SELECTED

config TLK_BOARD_TLSR9228A_EVK
    depends on TLK_SOC_TLSR9228A
    bool "TLSR9228A_EVK"
    select TLK_HAS_BOARD_SELECTED

config TLK_BOARD_TLSR9528A_DONGLE
    depends on TLK_SOC_TLSR9528A
    bool "TLSR9528A_DONGLE"
    select TLK_HAS_BOARD_SELECTED

config TLK_BOARD_TLSR9528A_EVK
    depends on TLK_SOC_TLSR9528A
    bool "TLSR9528A_EVK"
    select TLK_HAS_BOARD_SELECTED

endchoice # Board


config TLK_BOARD
    string
    default "TL3218X_EVK" if TLK_BOARD_TL3218X_EVK
    default "TL7218X_EVK" if TLK_BOARD_TL7218X_EVK
    default "TLSR9228A_EVK" if TLK_BOARD_TLSR9228A_EVK
    default "TLSR9528A_DONGLE" if TLK_BOARD_TLSR9528A_DONGLE
    default "TLSR9528A_EVK" if TLK_BOARD_TLSR9528A_EVK
```

## ci_configs/TL321X/gpio/max_all.defconfig
```kconfig
CONFIG_TLK_DMA=y
CONFIG_TLK_DMA_IRQ_HANDLER=y
CONFIG_TLK_DMA_PM_DEVICE=y
CONFIG_TLK_DMA_PREVENT_SLEEP=y
CONFIG_TLK_GPIO_PREVENT_SLEEP=y
CONFIG_TLK_PLIC_SW=y
CONFIG_TLK_PM=y
CONFIG_TLK_PM_DEEP_SLEEP=y
CONFIG_TLK_PM_ALLOW_FALLBACK_TO_SUSPEND=y
CONFIG_TLK_PM_RAM_RETENTION_ENABLE=y
CONFIG_TLK_UART=y
CONFIG_TLK_UART0_ENABLED=y
CONFIG_TLK_UART0_FLOW_CONTROL_RTS_CTS=y
CONFIG_TLK_UART0_FLOW_CONTROL=y
CONFIG_TLK_UART0_IRQ_HANDLER=y
CONFIG_TLK_UART0_PM_DEVICE=y
CONFIG_TLK_UART0_PREVENT_SLEEP=y
CONFIG_TLK_UART1_ENABLED=y
CONFIG_TLK_UART1_AUTO_CONFIG=y
CONFIG_TLK_UART1_FLOW_CONTROL_RTS_CTS=y
CONFIG_TLK_UART1_FLOW_CONTROL=y
CONFIG_TLK_UART1_IRQ_HANDLER=y
CONFIG_TLK_UART1_PM_DEVICE=y
CONFIG_TLK_UART1_PREVENT_SLEEP=y
CONFIG_TLK_UART2_ENABLED=y
CONFIG_TLK_UART2_AUTO_CONFIG=y
CONFIG_TLK_UART2_FLOW_CONTROL_RTS_CTS=y
CONFIG_TLK_UART2_FLOW_CONTROL=y
CONFIG_TLK_UART2_IRQ_HANDLER=y
CONFIG_TLK_UART2_PM_DEVICE=y
CONFIG_TLK_UART2_PREVENT_SLEEP=y
CONFIG_TLK_DEBUG_PRINT=y
CONFIG_TLK_GPIO_DEMO_INTERRUPT=y
```

## ci_configs/TL321X/gpio/retention.defconfig
```kconfig
# CONFIG_TLK_GPIO_PORT_A_ENABLED is not set
# CONFIG_TLK_GPIO_PORT_C_ENABLED is not set
# CONFIG_TLK_GPIO_PORT_E_ENABLED is not set
# CONFIG_TLK_GPIO_PORT_F_ENABLED is not set
# CONFIG_TLK_GPIO_PORT_G_ENABLED is not set
CONFIG_TLK_PM=y
# CONFIG_TLK_PM_SUSPEND is not set
CONFIG_TLK_PM_DEEP_SLEEP=y
CONFIG_TLK_PM_RAM_RETENTION_ENABLE=y
```

## ci_configs/TL321X/irq_nesting/suspend.defconfig
```kconfig
# CONFIG_TLK_PLIC_VECTOR_MODE is not set
CONFIG_TLK_PM=y
CONFIG_TLK_UART1_IRQ_HANDLER=y
CONFIG_TLK_NEST_INTO_MTIMER=y
CONFIG_TLK_NEST_SW=y
CONFIG_TLK_NEST_EXT=y
CONFIG_TLK_UART1_ENABLED=y
CONFIG_TLK_UART1_TX_MODE="TLK_UART_XFER_BLOCKING"
CONFIG_TLK_UART1_RX_MODE="TLK_UART_XFER_BLOCKING"
CONFIG_TLK_DEBUG_PRINT=y
CONFIG_TLK_DEBUG_UART1=y
CONFIG_TLK_DEBUG_UART="TLK_UART0"
CONFIG_TLK_DEBUG_PRINT_BUFFER_SIZE=256
```

## ci_configs/TL321X/pm/max.defconfig
```kconfig
CONFIG_TLK_API_SLEEP=y
CONFIG_TLK_PM_DEEP_SLEEP=y
CONFIG_TLK_PM_ALLOW_FALLBACK_TO_SUSPEND=y
CONFIG_TLK_PM_RAM_RETENTION_ENABLE=y
```

## ci_configs/TL321X/uart/max.defconfig
```kconfig
CONFIG_TLK_API_SLEEP=y
CONFIG_TLK_DMA=y
CONFIG_TLK_DMA_IRQ_HANDLER=y
CONFIG_TLK_PM=y
CONFIG_TLK_UART0_ENABLED=y
CONFIG_TLK_UART0_FLOW_CONTROL_RTS_CTS=y
CONFIG_TLK_UART0_FLOW_CONTROL=y
CONFIG_TLK_UART0_TX_MODE="TLK_UART_XFER_BLOCKING"
CONFIG_TLK_UART0_RX_MODE="TLK_UART_XFER_BLOCKING"
CONFIG_TLK_UART0_PM_DEVICE=y
CONFIG_TLK_UART0_PREVENT_SLEEP=y
CONFIG_TLK_UART1_ENABLED=y
CONFIG_TLK_UART1_AUTO_CONFIG=y
CONFIG_TLK_UART1_FLOW_CONTROL_RTS_CTS=y
CONFIG_TLK_UART1_FLOW_CONTROL=y
CONFIG_TLK_UART1_TX_MODE="TLK_UART_XFER_BLOCKING"
CONFIG_TLK_UART1_RX_MODE="TLK_UART_XFER_BLOCKING"
CONFIG_TLK_UART1_PM_DEVICE=y
CONFIG_TLK_UART1_PREVENT_SLEEP=y
CONFIG_TLK_UART2_ENABLED=y
CONFIG_TLK_UART2_AUTO_CONFIG=y
CONFIG_TLK_UART2_FLOW_CONTROL_RTS_CTS=y
CONFIG_TLK_UART2_FLOW_CONTROL=y
CONFIG_TLK_UART2_TX_MODE="TLK_UART_XFER_BLOCKING"
CONFIG_TLK_UART2_RX_MODE="TLK_UART_XFER_BLOCKING"
CONFIG_TLK_UART2_PM_DEVICE=y
CONFIG_TLK_UART2_PREVENT_SLEEP=y
CONFIG_TLK_DEBUG_PRINT=y
```

## ci_configs/TL321X/uart/min.defconfig
```kconfig
CONFIG_TLK_API_SLEEP=y
CONFIG_TLK_UART1_ENABLED=y
CONFIG_TLK_UART1_TX_MODE="TLK_UART_XFER_BLOCKING"
CONFIG_TLK_UART1_RX_MODE="TLK_UART_XFER_BLOCKING"
```

## ci_configs/TL321X/uart/retention.defconfig
```kconfig
CONFIG_TLK_API_SLEEP=y
CONFIG_TLK_PM=y
CONFIG_TLK_PM_DEEP_SLEEP=y
CONFIG_TLK_PM_RAM_RETENTION_ENABLE=y
CONFIG_TLK_UART_PM_DEVICE=y
CONFIG_TLK_UART1_ENABLED=y
CONFIG_TLK_UART1_TX_MODE="TLK_UART_XFER_BLOCKING"
CONFIG_TLK_UART1_RX_MODE="TLK_UART_XFER_BLOCKING"
CONFIG_TLK_UART1_PM_DEVICE=y
```

## ci_configs/TL721X/gpio/min.defconfig
```kconfig
# CONFIG_TLK_GPIO_PORT_A_ENABLED is not set
# CONFIG_TLK_GPIO_PORT_B_ENABLED is not set
# CONFIG_TLK_GPIO_PORT_D_ENABLED is not set
# CONFIG_TLK_GPIO_PORT_E_ENABLED is not set
# CONFIG_TLK_GPIO_PORT_F_ENABLED is not set
# CONFIG_TLK_GPIO_PORT_G_ENABLED is not set
```

## ci_configs/TLSR952X/gpio/min.defconfig
```kconfig
# CONFIG_TLK_GPIO_PORT_A_ENABLED is not set
# CONFIG_TLK_GPIO_PORT_B_ENABLED is not set
# CONFIG_TLK_GPIO_PORT_C_ENABLED is not set
# CONFIG_TLK_GPIO_PORT_E_ENABLED is not set
# CONFIG_TLK_GPIO_PORT_F_ENABLED is not set
# CONFIG_TLK_GPIO_PORT_G_ENABLED is not set
```

## ci_configs/TLSR952X/pm/retention.defconfig
```kconfig
CONFIG_TLK_API_SLEEP=y
# CONFIG_TLK_PM_SUSPEND is not set
CONFIG_TLK_PM_DEEP_SLEEP=y
CONFIG_TLK_PM_RAM_RETENTION_ENABLE=y
```

## core/Kconfig
```kconfig
config TLK_CORE_B92
    bool

config TLK_CORE_TL321X
    bool

config TLK_CORE_TL721X
    bool

config TLK_CORE
    string
    default "B92" if TLK_CORE_B92
    default "TL321X" if TLK_CORE_TL321X
    default "TL721X" if TLK_CORE_TL721X
    
```
